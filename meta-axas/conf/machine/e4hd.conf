## meta-openpli/conf/distro/reporefs.conf
```bitbake
SRCREV_pn-firmware-af9005 ??= "4b2b151e1842d172e76c2e0a6bfa1f4284a5e344"
SRCREV_pn-firmware-as102-data1-st ??= "4b2b151e1842d172e76c2e0a6bfa1f4284a5e344"
SRCREV_pn-firmware-as102-data2-st ??= "4b2b151e1842d172e76c2e0a6bfa1f4284a5e344"
SRCREV_pn-firmware-cx231xx ??= "4b2b151e1842d172e76c2e0a6bfa1f4284a5e344"
SRCREV_pn-firmware-drx397xd.a2 ??= "4b2b151e1842d172e76c2e0a6bfa1f4284a5e344"
SRCREV_pn-firmware-drx397xd.b1 ??= "4b2b151e1842d172e76c2e0a6bfa1f4284a5e344"
SRCREV_pn-firmware-drxd-a2-1.1 ??= "4b2b151e1842d172e76c2e0a6bfa1f4284a5e344"
SRCREV_pn-firmware-drxd-b1-1.1 ??= "4b2b151e1842d172e76c2e0a6bfa1f4284a5e344"
SRCREV_pn-firmware-dvb-demod-m88ds3103 ??= "4b2b151e1842d172e76c2e0a6bfa1f4284a5e344"
SRCREV_pn-firmware-dvb-demod-mn88472-02 ??= "4b2b151e1842d172e76c2e0a6bfa1f4284a5e344"
SRCREV_pn-firmware-dvb-demod-mn88473-01 ??= "4b2b151e1842d172e76c2e0a6bfa1f4284a5e344"
SRCREV_pn-firmware-dvb-demod-si2168-a20 ??= "4b2b151e1842d172e76c2e0a6bfa1f4284a5e344"
SRCREV_pn-firmware-dvb-demod-si2168-a30 ??= "4b2b151e1842d172e76c2e0a6bfa1f4284a5e344"
SRCREV_pn-firmware-dvb-demod-si2168-b40 ??= "4b2b151e1842d172e76c2e0a6bfa1f4284a5e344"
SRCREV_pn-firmware-dvb-demod-si2168-d60 ??= "4b2b151e1842d172e76c2e0a6bfa1f4284a5e344"
SRCREV_pn-firmware-dvb-fe-af9013 ??= "4b2b151e1842d172e76c2e0a6bfa1f4284a5e344"
SRCREV_pn-firmware-dvb-fe-cx24117 ??= "4b2b151e1842d172e76c2e0a6bfa1f4284a5e344"
SRCREV_pn-firmware-dvb-fe-ds3000 ??= "4b2b151e1842d172e76c2e0a6bfa1f4284a5e344"
SRCREV_pn-firmware-dvb-fe-tda10071 ??= "4b2b151e1842d172e76c2e0a6bfa1f4284a5e344"
SRCREV_pn-firmware-dvb-fe-xc5000-1.1 ??= "4b2b151e1842d172e76c2e0a6bfa1f4284a5e344"
SRCREV_pn-firmware-dvb-fe-xc5000-1.6.114 ??= "4b2b151e1842d172e76c2e0a6bfa1f4284a5e344"
SRCREV_pn-firmware-dvb-nova-12mhz-b0 ??= "4b2b151e1842d172e76c2e0a6bfa1f4284a5e344"
SRCREV_pn-firmware-dvb-siano ??= "4b2b151e1842d172e76c2e0a6bfa1f4284a5e344"
SRCREV_pn-firmware-dvb-tuner-si2141-a10 ??= "4b2b151e1842d172e76c2e0a6bfa1f4284a5e344"
SRCREV_pn-firmware-dvb-tuner-si2158-a20 ??= "4b2b151e1842d172e76c2e0a6bfa1f4284a5e344"
SRCREV_pn-firmware-dvb-usb-adstech-usb2-02 ??= "4b2b151e1842d172e76c2e0a6bfa1f4284a5e344"
SRCREV_pn-firmware-dvb-usb-af9015 ??= "4b2b151e1842d172e76c2e0a6bfa1f4284a5e344"
SRCREV_pn-firmware-dvb-usb-af9035-01 ??= "4b2b151e1842d172e76c2e0a6bfa1f4284a5e344"
SRCREV_pn-firmware-dvb-usb-af9035-02 ??= "4b2b151e1842d172e76c2e0a6bfa1f4284a5e344"
SRCREV_pn-firmware-dvb-usb-avertv-a800-02 ??= "4b2b151e1842d172e76c2e0a6bfa1f4284a5e344"
SRCREV_pn-firmware-dvb-usb-bluebird-01 ??= "4b2b151e1842d172e76c2e0a6bfa1f4284a5e344"
SRCREV_pn-firmware-dvb-usb-bluebird-02 ??= "4b2b151e1842d172e76c2e0a6bfa1f4284a5e344"
SRCREV_pn-firmware-dvb-usb-dib0700-01 ??= "4b2b151e1842d172e76c2e0a6bfa1f4284a5e344"
SRCREV_pn-firmware-dvb-usb-dib0700-03-pre1 ??= "4b2b151e1842d172e76c2e0a6bfa1f4284a5e344"
SRCREV_pn-firmware-dvb-usb-dib0700-1.10 ??= "4b2b151e1842d172e76c2e0a6bfa1f4284a5e344"
SRCREV_pn-firmware-dvb-usb-dib0700-1.20 ??= "4b2b151e1842d172e76c2e0a6bfa1f4284a5e344"
SRCREV_pn-firmware-dvb-usb-dibusb-5.0.0.11 ??= "4b2b151e1842d172e76c2e0a6bfa1f4284a5e344"
SRCREV_pn-firmware-dvb-usb-dibusb-6.0.0.8 ??= "4b2b151e1842d172e76c2e0a6bfa1f4284a5e344"
SRCREV_pn-firmware-dvb-usb-dibusb-an2235-01 ??= "4b2b151e1842d172e76c2e0a6bfa1f4284a5e344"
SRCREV_pn-firmware-dvb-usb-digitv-02 ??= "4b2b151e1842d172e76c2e0a6bfa1f4284a5e344"
SRCREV_pn-firmware-dvb-usb-digivox-02 ??= "4b2b151e1842d172e76c2e0a6bfa1f4284a5e344"
SRCREV_pn-firmware-dvb-usb-dposh-01 ??= "4b2b151e1842d172e76c2e0a6bfa1f4284a5e344"
SRCREV_pn-firmware-dvb-usb-dtt200u-01 ??= "4b2b151e1842d172e76c2e0a6bfa1f4284a5e344"
SRCREV_pn-firmware-dvb-usb-ec168 ??= "4b2b151e1842d172e76c2e0a6bfa1f4284a5e344"
SRCREV_pn-firmware-dvb-usb-it9135 ??= "4b2b151e1842d172e76c2e0a6bfa1f4284a5e344"
SRCREV_pn-firmware-dvb-usb-it913x ??= "4b2b151e1842d172e76c2e0a6bfa1f4284a5e344"
SRCREV_pn-firmware-dvb-usb-megasky-02 ??= "4b2b151e1842d172e76c2e0a6bfa1f4284a5e344"
SRCREV_pn-firmware-dvb-usb-nova-t-usb2-01 ??= "4b2b151e1842d172e76c2e0a6bfa1f4284a5e344"
SRCREV_pn-firmware-dvb-usb-nova-t-usb2-02 ??= "4b2b151e1842d172e76c2e0a6bfa1f4284a5e344"
SRCREV_pn-firmware-dvb-usb-s660 ??= "4b2b151e1842d172e76c2e0a6bfa1f4284a5e344"
SRCREV_pn-firmware-dvb-usb-tbs5520 ??= "4b2b151e1842d172e76c2e0a6bfa1f4284a5e344"
SRCREV_pn-firmware-dvb-usb-tbs5925 ??= "4b2b151e1842d172e76c2e0a6bfa1f4284a5e344"
SRCREV_pn-firmware-dvb-usb-tbs5980 ??= "4b2b151e1842d172e76c2e0a6bfa1f4284a5e344"
SRCREV_pn-firmware-dvb-usb-technisat-skystar ??= "4b2b151e1842d172e76c2e0a6bfa1f4284a5e344"
SRCREV_pn-firmware-dvb-usb-tvwalkert ??= "4b2b151e1842d172e76c2e0a6bfa1f4284a5e344"
SRCREV_pn-firmware-dvb-usb-umt-010-02 ??= "4b2b151e1842d172e76c2e0a6bfa1f4284a5e344"
SRCREV_pn-firmware-dvb-usb-wt220u-02 ??= "4b2b151e1842d172e76c2e0a6bfa1f4284a5e344"
SRCREV_pn-firmware-dvb-usb-wt220u-fc03 ??= "4b2b151e1842d172e76c2e0a6bfa1f4284a5e344"
SRCREV_pn-firmware-dvb-usb-wt220u-miglia-01 ??= "4b2b151e1842d172e76c2e0a6bfa1f4284a5e344"
SRCREV_pn-firmware-dvb-usb-wt220u-zl0353-01 ??= "4b2b151e1842d172e76c2e0a6bfa1f4284a5e344"
SRCREV_pn-firmware-isdbt-nova-12mhz-b0 ??= "4b2b151e1842d172e76c2e0a6bfa1f4284a5e344"
SRCREV_pn-firmware-marvell-sd8688 ??= "4b2b151e1842d172e76c2e0a6bfa1f4284a5e344"
SRCREV_pn-firmware-sms1xxx-nova-b-dvbt-01 ??= "4b2b151e1842d172e76c2e0a6bfa1f4284a5e344"
SRCREV_pn-firmware-sms1xxx-hcw-114xxx-cmmb-01 ??= "4b2b151e1842d172e76c2e0a6bfa1f4284a5e344"
SRCREV_pn-firmware-sms1xxx-hcw-55xxx-dvbt-01 ??= "4b2b151e1842d172e76c2e0a6bfa1f4284a5e344"
SRCREV_pn-firmware-sms1xxx-hcw-55xxx-dvbt-02 ??= "4b2b151e1842d172e76c2e0a6bfa1f4284a5e344"
SRCREV_pn-firmware-sms1xxx-hcw-55xxx-dvbt-03 ??= "4b2b151e1842d172e76c2e0a6bfa1f4284a5e344"
SRCREV_pn-firmware-sms1xxx-hcw-55xxx-isdbt-02 ??= "4b2b151e1842d172e76c2e0a6bfa1f4284a5e344"
SRCREV_pn-firmware-sms1xxx-hcw-55xxx-isdbt-03 ??= "4b2b151e1842d172e76c2e0a6bfa1f4284a5e344"
SRCREV_pn-firmware-sms1xxx-nova-a-dvbt-01 ??= "4b2b151e1842d172e76c2e0a6bfa1f4284a5e344"
SRCREV_pn-firmware-xc3028-dvico-au-01 ??= "4b2b151e1842d172e76c2e0a6bfa1f4284a5e344"
SRCREV_pn-firmware-xc3028-v27 ??= "4b2b151e1842d172e76c2e0a6bfa1f4284a5e344"
SRCREV_pn-firmware-xc3028l-v36 ??= "4b2b151e1842d172e76c2e0a6bfa1f4284a5e344"
SRCREV_pn-firmware-xc5000 ??= "4b2b151e1842d172e76c2e0a6bfa1f4284a5e344"
SRCREV_pn-firmware-xc5000c ??= "4b2b151e1842d172e76c2e0a6bfa1f4284a5e344"

# usb wlan linux firmwares
SRCREV_pn-firmware-atheros-ar9271 ??= "4b2b151e1842d172e76c2e0a6bfa1f4284a5e344"
SRCREV_pn-firmware-carl9170 ??= "4b2b151e1842d172e76c2e0a6bfa1f4284a5e344"
SRCREV_pn-firmware-htc7010 ??= "4b2b151e1842d172e76c2e0a6bfa1f4284a5e344"
SRCREV_pn-firmware-htc9271 ??= "4b2b151e1842d172e76c2e0a6bfa1f4284a5e344"
SRCREV_pn-firmware-mt7601u ??= "4b2b151e1842d172e76c2e0a6bfa1f4284a5e344"
SRCREV_pn-firmware-mt7650 ??= "4b2b151e1842d172e76c2e0a6bfa1f4284a5e344"
SRCREV_pn-firmware-rt2870 ??= "4b2b151e1842d172e76c2e0a6bfa1f4284a5e344"
SRCREV_pn-firmware-rt73 ??= "4b2b151e1842d172e76c2e0a6bfa1f4284a5e344"
SRCREV_pn-firmware-rtl8188eu ??= "4b2b151e1842d172e76c2e0a6bfa1f4284a5e344"
SRCREV_pn-firmware-rtl8188fu ??= "4b2b151e1842d172e76c2e0a6bfa1f4284a5e344"
SRCREV_pn-firmware-rtl8192cu ??= "4b2b151e1842d172e76c2e0a6bfa1f4284a5e344"
SRCREV_pn-firmware-rtl8192eu ??= "4b2b151e1842d172e76c2e0a6bfa1f4284a5e344"
SRCREV_pn-firmware-rtl8712u ??= "4b2b151e1842d172e76c2e0a6bfa1f4284a5e344"
SRCREV_pn-firmware-rtl8723bs ??= "4b2b151e1842d172e76c2e0a6bfa1f4284a5e344"
SRCREV_pn-firmware-rtl8723bu ??= "4b2b151e1842d172e76c2e0a6bfa1f4284a5e344"
SRCREV_pn-firmware-rtl8822be ??= "4b2b151e1842d172e76c2e0a6bfa1f4284a5e344"
SRCREV_pn-firmware-rtl8xxxu ??= "4b2b151e1842d172e76c2e0a6bfa1f4284a5e344"
SRCREV_pn-firmware-zd1211 ??= "4b2b151e1842d172e76c2e0a6bfa1f4284a5e344"

# e2openplugins
SRCREV_pn-enigma2-plugin-extensions-addstreamurl ??= "c94fb2b9e8e858cff8af4ef230b801868e8c3f11"
SRCREV_pn-enigma2-plugin-extensions-analogclock ??= "96586716ba7d41d22851ea44c2f4b0a218c55d24"
SRCREV_pn-enigma2-plugin-extensions-antilogo ??= "a90e64cde3a1d141e266de63444309d21f5a3d94"
SRCREV_pn-enigma2-plugin-extensions-autobackup ??= "5df93c2e8149129527f6c08294df260de7ba5f4d"
SRCREV_pn-enigma2-plugin-extensions-autobouquets ??= "3fc227bb700374605c825db6335b548e8ade869e"
SRCREV_pn-enigma2-plugin-extensions-bhtunerserver ??= "${AUTOREV}"
SRCREV_pn-enigma2-plugin-extensions-bitrate ??= "d55ee41490c8f638329643c5e5c1c8c49648592a"
SRCREV_pn-enigma2-plugin-extensions-blackoutblind ??= "83baad56494728b795f828f6abeb6ebc26dd1514"
SRCREV_pn-enigma2-plugin-extensions-cacheflush ??= "deb3f9b22ae962d8e22d06e122c5184c845fbd14"
SRCREV_pn-enigma2-plugin-extensions-changerootpassword ??= "589cfda1dd01bae61a193f074c71ff99cc2290a0"
SRCREV_pn-enigma2-plugin-extensions-czechmeteo ??= "475a8c11df3976a74c4aed199f36f3ecd331cf1c"
SRCREV_pn-enigma2-plugin-extensions-epgimportfilter ??= "b20621edac5f6dbdc51c42c503e78b18e8286029"
SRCREV_pn-enigma2-plugin-extensions-filecommander ??= "23c11a868641cdbda12e0c6541abfc815f224ed2"
SRCREV_pn-enigma2-plugin-extensions-foreca ??= "2351f7ef2f91da7f21c1b72ae90579dfba2054be"
SRCREV_pn-enigma2-plugin-extensions-hetweer ??= "859b6e667c21ab3335704e636bad86eece1c1090"
SRCREV_pn-enigma2-plugin-extensions-infobarweather ??= "2dabbd9265a05e7e207e83bc9241b5b85879f797"
SRCREV_pn-enigma2-plugin-extensions-magentamusik360 ??= "3ef387ebeff2d4e027fbfcc70f8144901d07b76c"
SRCREV_pn-enigma2-plugin-extensions-meteoviewer ??= "602c8d0a18c640ef1efd589a9c2d731becfa707e"
SRCREV_pn-enigma2-plugin-extensions-newsreader ??= "edc525baef85b85af418cf1b0ee7da5d68780a3b"
SRCREV_pn-enigma2-plugin-extensions-nfsserver ??= "e7880e3fd7d6167bd47a8db759a4c0c8a1f044c1"
SRCREV_pn-enigma2-plugin-extensions-openairplay ??= "${AUTOREV}"
SRCREV_pn-enigma2-plugin-extensions-openwebif ??= "e46534fb6696cb33eb36ed9982d9e5db1bd8a31e"
SRCREV_pn-enigma2-plugin-extensions-oroscopoitalia ??= "42ceffdade8719c30d5f5dc8f64b61eda3762a1f"
SRCREV_pn-enigma2-plugin-extensions-oscamstatus ??= "0004ed50f79a97c51007306550fbe699b53f038d"
SRCREV_pn-enigma2-plugin-extensions-permanentvfdclock ??= "2a07a31b1789fa6bb245e9160700ce42835e725b"
SRCREV_pn-enigma2-plugin-extensions-ppanel ??= "3f07fff734627ce7ed4d65494aedbbda18a9583c"
SRCREV_pn-enigma2-plugin-extensions-remotecontrolchannel ??= "fa7538b0fd1a2e7f6f03541e4c78df501a5665be"
SRCREV_pn-enigma2-plugin-extensions-remotechannelstreamconverter ??= "0c021ed3ab0db855063d36cde8453dc49eec28c5"
SRCREV_pn-enigma2-plugin-extensions-screenposition ??= "0b2e06b2580ce486bc52e99508b8ee045aacc936"
SRCREV_pn-enigma2-plugin-extensions-serienrecorder ??= "92affb1720381db3f040e5c7fe051b9752481d83"
SRCREV_pn-enigma2-plugin-extensions-setpicon ??= "6b777ed10fba7a825ba99ca8a27f6c381dee6d16"
SRCREV_pn-enigma2-plugin-extensions-shootyourscreen ??= "abd5cda28ce51add3d049ae91f2f1fc2247d6bda"
SRCREV_pn-enigma2-plugin-extensions-simpleumount ??= "${AUTOREV}"
SRCREV_pn-enigma2-plugin-extensions-snmpagent ??= "450ed959a78918a08a3df5a58acb99d2bdc90f5b"
SRCREV_pn-enigma2-plugin-extensions-streaminterface ??= "faf0c907fefa67d777f3745c9eab957794b8a727"
SRCREV_pn-enigma2-plugin-extensions-systemtools ??= "88dbcac49202a4d850221841b8f16891f684a375"
SRCREV_pn-enigma2-plugin-extensions-telekomsport ??= "e2f3882418baedb2c02d7265c932a2e9d3e84b1c"
SRCREV_pn-enigma2-plugin-extensions-usbformatwizard ??= "${AUTOREV}"
SRCREV_pn-enigma2-plugin-extensions-wakeonlan ??= "e36eb4e0a395c0c721fbcbf45f93b895c2fab430"
SRCREV_pn-enigma2-plugin-extensions-xpower ??= "a61decfcf1b7508ad18bebe4471e4a9e68e81ada"
SRCREV_pn-enigma2-plugin-systemplugins-autobouquetsmaker ??= "18073ce41e31df7fec475c210a832bb522a1d99e"
SRCREV_pn-enigma2-plugin-systemplugins-autoshutdown ??= "1652534fc40ac7423dc87a65c0ed0d7a55de4745"
SRCREV_pn-enigma2-plugin-systemplugins-crossepg ??= "63d495c3a86a639fbb7d79f54ca7c0abc196a770"
SRCREV_pn-enigma2-plugin-systemplugins-misplslcnscan ??= "82f7d412384e19b1ef4d0bf472b4c8aa609f98c6"
SRCREV_pn-enigma2-plugin-systemplugins-terrestrialscan ??= "751301c3b24fec07609bccf5494d8924feac9558"
SRCREV_pn-enigma2-plugin-systemplugins-satscan ??= "97f621806138d80ef46fc31dffb227d21340347b"
SRCREV_pn-enigma2-plugin-systemplugins-servicemp3 ??= "bdb5a908276b69a913ca50cb8c274d1b5977ad82"

# enigma2 and binaries
SRCREV_pn-aio-grab ??= "6540d2d6e327965d06151f29fb60e3444eeadb00"
SRCREV_pn-astra-sm ??= "44bcd2852b7f315233267f639730e0e21b9b6c22"
SRCREV_pn-bitstream ??= "844d77d1c30d9f94a9399f1dec217a89bff58276"
SRCREV_pn-blindscan-s2 ??= "632830aca27f22a412641998dee84319182d44e0"
SRCREV_pn-dcadec ??= "b93deed1a231dd6dd7e39b9fe7d2abe05aa00158"
SRCREV_pn-dvblast ??= "25e0f9b0e274eb9386ff562dcda02e6b0271fbe4"
SRCREV_pn-dvbsnoop ??= "5b236b178ee1bc6cd6e16ff88ba5748b24237691"
SRCREV_pn-dvdauthor ??= "fe8fe3578f95f34889e7ed17591d02dceb4f42ed"
SRCREV_pn-edid-decode ??= "5332a3b76080e17137db15fd31e2d3949cef5f84"
SRCREV_pn-enigma2 ??= "${AUTOREV}"
SRCREV_pn-exteplayer3 ??= "e258b47863fae1d74dbd1d707c948ae4232fea64"
SRCREV_pn-fakelocale ??= "586590f28af205ced71f45a0e3f67abec82622fd"
SRCREV_pn-hotplug-e2-helper ??= "68eedb242efc29289c71e0d2694bf47795df3c7f"
SRCREV_pn-minidlna ??= "cfb775682b88f6349cb7fa64f82fe33035436157"
SRCREV_pn-satipclient ??= "1c2ef4c13604e4edeb4d553c67e2d317e2040eab"
SRCREV_pn-shairplay ??= "096b61ad14c90169f438e690d096e3fcf87e504e"
SRCREV_pn-streamproxy ??= "69c1af014bf7270f0e904e5f020cb6a892d6931d"
SRCREV_pn-tuxbox-common ??= "${AUTOREV}"
SRCREV_pn-tuxtxt-enigma2 ??= "1402795d660955757d87967b8ff1e3790625f9c1"
SRCREV_pn-udpxy ??= "93d427f0fc181837b8294db072303c3310f88b6d"
SRCREV_pn-upscaledb ??= "${AUTOREV}"
SRCREV_pn-satipclient ??= "1c2ef4c13604e4edeb4d553c67e2d317e2040eab"
SRCREV_pn-satpi ??= "09df7402870b1dff2c7b2d7f4a085002a333045f"
SRCREV_pn-enigma2-boxlogos ??= "45a845077cfb41a9b7f0c58f51a2528103b1dca1"

# ffmpeg
SRCREV_pn-ffmpeg ??= "b48951bd29fbec166428efb5a0e27f51ff98fd84"

# gstreamer
SRCREV_pn-gstreamer1.0-plugin-dvbmediasink ??= "1d197313832d39fdaf430634f62ad95a33029db0"
SRCREV_pn-gstreamer1.0-plugin-subsink ??= "2c4288bb29e0781f27aecc25c941b6e441630f8d"
SRCREV_pn-gst-ifdsrc ??= "3beb10950bb79977339d9ca6c638bf962392fca4"
SRCREV_pn-gst-plugin-subsink ??= "${AUTOREV}"
SRCREV_pn-gstplayer ??= "a289516735c506c5db3b8ab146d3cd3db2674ddc"

# libs
SRCREV_pn-libaacs ??= "${AUTOREV}"
SRCREV_pn-libbluray ??= "236b5c8f42bbd9400d2e04f397a5427b83a47fd4"
SRCREV_pn-libdca ??= "95c4bd8baee808ec563120f463111e2cd6cd240e"
SRCREV_pn-libdreamdvd ??= "02a0e7cb0c37f98fbbaae087f7f5c010c5c7c9a3"
SRCREV_pn-libdvbsi++ ??= "f3c40ea6daa94a3bfeeee1ef9381c68629a68b81"
SRCREV_pn-libdvdnav ??= "25229a54b2c4be9930d677f6abe3a0025514f3db"
SRCREV_pn-libdvdread ??= "329ec88257ecaf64a3144644a423289bb3da8ef6"
SRCREV_pn-libsquish ??= "52e7d93c5947f72380521116c05d97c528863ba8"
SRCREV_pn-libtuxtxt ??= "1402795d660955757d87967b8ff1e3790625f9c1"
SRCREV_pn-libudfread ??= "b3e6936a23f8af30a0be63d88f4695bdc0ea26e1"
SRCREV_pn-libdvbcsa ??= "f25351d70589ec97ae6fb7590786c9aa38b999d4"

# dima-plugins
SRCREV_pn-enigma2-plugin-extensions-automatic-fullbackup ??= "6dbe090874c831d9fdfd657722fdf9f5903c3927"
SRCREV_pn-enigma2-plugin-extensions-historyzapselector ??= "0c880416c777203525e69fd5679b34ebab7a1006"
SRCREV_pn-enigma2-plugin-extensions-sundtekcontrolcenter ??= "63b84e1c50666b5fdd65f2b6f6abe45da3340176"
SRCREV_pn-enigma2-plugin-extensions-tmbd ??= "d9b6ffe054951d97f46b2114179e320d91035c32"
SRCREV_pn-enigma2-plugin-extensions-ts-sateditor ??= "d99a26e3cd3c7bd46b9c7c96e9bf3675d5f1d9a9"
SRCREV_pn-enigma2-plugin-extensions-vcs ??= "ace56dcc2975ab55a72137c7382e2c8c37244691"
SRCREV_pn-enigma2-plugin-extensions-xmodem ??= "0458a1cf91e758c20014c5093d88677d8d8032b2"
SRCREV_pn-enigma2-plugin-systemplugins-devicemanager ??= "26c02aad93a8cd0d378aba47215dcd477166702a"
SRCREV_pn-enigma2-plugin-systemplugins-extnumberzap ??= "193ee3ef5bb0bd584df170892840e941b06dd6ed"
SRCREV_pn-enigma2-plugin-systemplugins-extrafancontrol ??= "ed50ac9c63717bd85c1843eb891637e7fa5900ba"
SRCREV_pn-enigma2-plugin-systemplugins-mountmanager ??= "be71327f31109794c982c9f1207b4b15ca8b88a4"
SRCREV_pn-enigma2-plugin-systemplugins-signalfinder ??= "336e90fe083e6452c5c0193780de4bf43d0fd6fa"
SRCREV_pn-enigma2-plugin-systemplugins-satipserver ??= "146216b8498e60c62eb55c71e1830d3977ce7bcd"

# plugins
SRCREV_pn-enigma2-plugin-extensions-backupsuite ??= "dbe70c75b12799b47109caee1059137d115a2044"
SRCREV_pn-enigma2-plugin-extensions-blurayplayer ??= "f66a10d683062fb2de44538e7b87412b15715b98"
SRCREV_pn-enigma2-plugin-extensions-dlnabrowser ??= "d2a51c715fd98415c7ef76b1b7c8d30854ecff98"
SRCREV_pn-enigma2-plugin-extensions-epgimport ??= "6b93ad5dfe846044ead419bb982d4b11427acea2"
SRCREV_pn-enigma2-plugin-extensions-epgimport-sources ??= "6f0fdeeae541641f6408149f2258043547fbfd21"
SRCREV_pn-enigma2-plugin-extensions-fontinfo ??= "cab3f53f4ba90140e4bda4ac8aa511f4c25d0044"
SRCREV_pn-enigma2-plugin-extensions-freechannels ??= "735d86d35da080fbac54cfcfc50f78f35779f88b"
SRCREV_pn-enigma2-plugin-extensions-fritzcall ??= "fb552f87ce4096411b03d826bb0a5f2bc36b6bd8"
SRCREV_pn-enigma2-plugin-extensions-hdmitest ??= "0da5420409726d7d215458709beb968a0fb04742"
SRCREV_pn-enigma2-plugin-extensions-jediepgxtream ??= "62f207e45e793010d2b605af3a90e1802498dfd7"
SRCREV_pn-enigma2-plugin-extensions-jedimakerxtream ??= "5d2218ae6fe0286d7103a87884f07ea57f92819d"
SRCREV_pn-enigma2-plugin-extensions-bouquetmakerxtream ??= "879dfd82ff186d66f7afc78db757bbf00d52b3ee"
SRCREV_pn-enigma2-plugin-extensions-kodi ??= "3d082e9c3d83e4af466d7507a5960c7a9a8813f1"
SRCREV_pn-enigma2-plugin-extensions-managerautofs ??= "427d569852f6bbfd7fa2c4f2323709a124163174"
SRCREV_pn-enigma2-plugin-extensions-modifyplifullhd ??= "5de9e609d02bf96357ff28ba9fdcf53f49d9bd71"
SRCREV_pn-enigma2-plugin-extensions-moviemanager ??= "dc87f7f542a8d59bc30882381bac25210fff89a5"
SRCREV_pn-enigma2-plugin-extensions-plutotv ??= "c358bea36da3fce2709fdc9e6d7b8888706e3d1c"
SRCREV_pn-enigma2-plugin-extensions-qthbbtv ??= "2067e667d7207b610c265c05690f3d13c0fc02f0"
SRCREV_pn-enigma2-plugin-extensions-qtstalker ??= "2067e667d7207b610c265c05690f3d13c0fc02f0"
SRCREV_pn-enigma2-plugin-extensions-refreshbouquet ??= "b98eb41efe75c36006caad6701bd379d257c4982"
SRCREV_pn-enigma2-plugin-extensions-subssupport ??= "7d583fe93736c860ee1d806f64fe5b4524acdef1"
SRCREV_pn-enigma2-plugin-extensions-xstreamity ??= "97fb028110bd96253977404f16d2e9a75f2b5a0c"
SRCREV_pn-enigma2-plugin-extensions-youtube ??= "15a7fba89b63476177ac083b032ee499262f64fb"
SRCREV_pn-enigma2-plugin-extensions-iptv-org-playlists ??= "4d0456a218c14bec4a0118c0d2bfd7fed2a5b4f0"
SRCREV_pn-enigma2-plugin-extensions-openmultiboot ??= "40f921733c07d0b19cf2281b9ba4c690ca09ada3"
SRCREV_pn-enigma2-plugin-systemplugins-hrtunerproxy ??= "30d0f9b66c186278d32a52a01a3cb6d63807042c"
SRCREV_pn-enigma2-plugin-systemplugins-quadpip ??= "a3195e60a48241ceea1dc4e4ead703640f4538ad"
SRCREV_pn-enigma2-plugin-systemplugins-serviceapp ??= "947f62ed5c8bcce76e5353193ae2e04c327e6140"
SRCREV_pn-enigma2-plugin-systemplugins-radiotimesxmltvemulator ??= "1b1d398ccdd82bdfbd92be0e186b14c8a21ae5c0"
SRCREV_pn-enigma2-plugin-systemplugins-terrestrialbouquet ??= "564df07777d64dd420eb1edd44170d29c08977b4"
SRCREV_pn-enigma2-plugin-systemplugins-m3uiptv ??= "4808a2913306c7ca84e31b136a32b5bef795b202"
SRCREV_pn-enigma2-binary-plugins ??= "483005f04fd2e5ea5079e4cf86f529aa2b9ec7a4"
SRCREV_pn-enigma2-plugins ??= "167a0a28bb9be7b890e64d3892bb66afc4a3f67b"

# python
SRCREV_pn-${PYTHON_PN}-sendfile ??= "2ffdd452b03dd4b639cda985bd67b8d4c0c34a5f"
SRCREV_pn-pydpflib ??= "fcd1158129188354986b023fdfb4d107597d7661"
SRCREV_pn-streamlink ??= "07d627fbeff67d143b8d5fbce4b8caf5bdc05944"

# settings
SRCREV_pn-enigma2-plugin-settings-hans-13e-19e-23e-28e ??= "${AUTOREV}"
SRCREV_pn-enigma2-plugin-settings-hans-19e-23e ??= "${AUTOREV}"
SRCREV_pn-enigma2-plugin-settings-hans-19e-23e-28e ??= "${AUTOREV}"
SRCREV_pn-enigma2-plugin-settings-hans-19e-23e-basis ??= "${AUTOREV}"
SRCREV_pn-enigma2-plugin-settings-hans-9e-13e-19e-23e-28e ??= "${AUTOREV}"
SRCREV_pn-enigma2-plugin-settings-hans-9e-13e-19e-23e-28e-rotating ??= "${AUTOREV}"
SRCREV_pn-enigma2-plugin-settings-hans-kabelnl ??= "${AUTOREV}"
SRCREV_pn-enigma2-plugin-settings-morph883-0.8w-13e-19.2e-28.2e ??= "${AUTOREV}"
SRCREV_pn-enigma2-plugin-settings-morph883-0.8w-13e-19.2e ??= "${AUTOREV}"
SRCREV_pn-enigma2-plugin-settings-morph883-0.8w-13e ??= "${AUTOREV}"
SRCREV_pn-enigma2-plugin-settings-morph883-0.8w-4.8e-13e ??= "${AUTOREV}"
SRCREV_pn-enigma2-plugin-settings-morph883-13e-16e-19.2e-23.5e ??= "${AUTOREV}"
SRCREV_pn-enigma2-plugin-settings-morph883-13e-16e-19.2e ??= "${AUTOREV}"
SRCREV_pn-enigma2-plugin-settings-morph883-13e-16e ??= "${AUTOREV}"
SRCREV_pn-enigma2-plugin-settings-morph883-13e-19.2e-23.5e ??= "${AUTOREV}"
SRCREV_pn-enigma2-plugin-settings-morph883-13e-19.2e-23.5e-28.2e ??= "${AUTOREV}"
SRCREV_pn-enigma2-plugin-settings-morph883-13e-19.2e-28.2e ??= "${AUTOREV}"
SRCREV_pn-enigma2-plugin-settings-morph883-13e-19.2e-42e ??= "${AUTOREV}"
SRCREV_pn-enigma2-plugin-settings-morph883-13e-19.2e ??= "${AUTOREV}"
SRCREV_pn-enigma2-plugin-settings-morph883-13e-23.5e ??= "${AUTOREV}"
SRCREV_pn-enigma2-plugin-settings-morph883-13e-28.2e ??= "${AUTOREV}"
SRCREV_pn-enigma2-plugin-settings-morph883-13e-42e ??= "${AUTOREV}"
SRCREV_pn-enigma2-plugin-settings-morph883-13e ??= "${AUTOREV}"
SRCREV_pn-enigma2-plugin-settings-morph883-30w-13e-19.2e ??= "${AUTOREV}"
SRCREV_pn-enigma2-plugin-settings-morph883-30w-13e ??= "${AUTOREV}"
SRCREV_pn-enigma2-plugin-settings-morph883-4.8e-13e-19.2e ??= "${AUTOREV}"
SRCREV_pn-enigma2-plugin-settings-morph883-4.8e-13e ??= "${AUTOREV}"
SRCREV_pn-enigma2-plugin-settings-morph883-9e-13e-19.2e ??= "${AUTOREV}"
SRCREV_pn-enigma2-plugin-settings-morph883-9e-13e ??= "${AUTOREV}"
SRCREV_pn-enigma2-plugin-settings-morph883-motor ??= "${AUTOREV}"
SRCREV_pn-enigma2-plugin-settings-ciefp-e2-1sat-19e ??= "${AUTOREV}"
SRCREV_pn-enigma2-plugin-settings-ciefp-e2-2sata-19e-13e ??= "${AUTOREV}"
SRCREV_pn-enigma2-plugin-settings-ciefp-e2-2satb-19e-16e ??= "${AUTOREV}"
SRCREV_pn-enigma2-plugin-settings-ciefp-e2-3sata-9e-10e-13e ??= "${AUTOREV}"
SRCREV_pn-enigma2-plugin-settings-ciefp-e2-3satb-19e-16e-13e ??= "${AUTOREV}"
SRCREV_pn-enigma2-plugin-settings-ciefp-e2-4sata-28e-19e-13e-30w ??= "${AUTOREV}"
SRCREV_pn-enigma2-plugin-settings-ciefp-e2-4satb-19e-16e-13e-0.8w ??= "${AUTOREV}"
SRCREV_pn-enigma2-plugin-settings-ciefp-e2-5sat-19e-16e-13e-1.9e-0.8w ??= "${AUTOREV}"
SRCREV_pn-enigma2-plugin-settings-ciefp-e2-6sat-23e-19e-16e-13e-1.9e-0.8w ??= "${AUTOREV}"
SRCREV_pn-enigma2-plugin-settings-ciefp-e2-7sat-23e-19e-16e-13e-4.8e-1.9e-0.8w ??= "${AUTOREV}"
SRCREV_pn-enigma2-plugin-settings-ciefp-e2-8sat-28e-23e-19e-16e-13e-4.8e-1.9e-0.8w ??= "${AUTOREV}"
SRCREV_pn-enigma2-plugin-settings-ciefp-e2-9sat-39e-28e-23e-19e-16e-13e-4.8e-1.9e-0.8w ??= "${AUTOREV}"
SRCREV_pn-enigma2-plugin-settings-ciefp-e2-10sat-39e-28e-23e-19e-16e-13e-9e-4.8e-1.9e-0.8w ??= "${AUTOREV}"
SRCREV_pn-enigma2-plugin-settings-ciefp-e2-13sat-42e-39e-28e-23e-19e-16e-13e-9e-7e-4.8e-1.9e-0.8w-5w ??= "${AUTOREV}"
SRCREV_pn-enigma2-plugin-settings-ciefp-e2-16sat-42e-39e-28e-26e-23e-19e-16e-13e-10e-9e-7e-4.8e-1.9e-0.8w-4w-5w ??= "${AUTOREV}"
SRCREV_pn-enigma2-plugin-settings-ciefp-e2-18sat-42e-39e-36e-33e-28e-26e-23e-19e-16e-13e-10e-9e-7e-4.8e-1.9e-0.8w-4w-5w ??= "${AUTOREV}"
SRCREV_pn-enigma2-plugin-settings-ciefp-e2-motor-75e-34w ??= "${AUTOREV}"

# skins
SRCREV_pn-enigma2-plugin-skins-magic ??= "8b5fb84750d8ed34048e6d6fa6e4fee1711de4d3"
SRCREV_pn-enigma2-plugin-skins-glamouraurafhd ??= "580813d47a7cf1f3a129ff6102ec945e59a65c05"
SRCREV_pn-enigma2-plugin-skins-e2darkos ??= "89e64d86e7b6f8a99a5ff1d9e3290c2496cb326a"
SRCREV_pn-enigma2-plugin-skins-pd1loi-hd-night ??= "0f06f71240e8d3731462820dbd39d2834267b094"
SRCREV_pn-enigma2-plugin-skins-pli-hd ??= "974a9a69c99f7f6c170a18c58b708c556392a610"
SRCREV_pn-enigma2-plugin-skins-pli-hd-fullnight ??= "99adc658e434d32f30994445e5396e17e154aa28"
SRCREV_pn-enigma2-plugin-skins-simple-gray ??= "80b158870a3033e96359e3251605b52d4d1b5a37"
SRCREV_pn-enigma2-skins ??= "472e9d9257dbef16205b00b3dc748eeddc10e3aa"

# softcams
SRCREV_pn-enigma2-plugin-softcams-oscam ??= "c656fef9b74e90533a1d756eb2e1c344ce4bbfcc"
SRCREV_pn-enigma2-plugin-softcams-oscam-emu ??= "7dafc611b81584f60fc75ed349bb02de4125b39c"
SRCREV_pn-enigma2-plugin-softcams-oscam-whitelist ??= "2afe8ba139eb874cf7c07cc13ae80971ba44b3f7"

# wlan kernel modules
SRCREV_pn-kernel-module-88xxau ??= "307d694076b056588c652c2bdaa543a89eb255d9"
SRCREV_pn-kernel-module-rt8188eu ??= "5fbebcb35b88c7eeaada387350d4aac19d98b461"
SRCREV_pn-kernel-module-8192eu ??= "ab35c7e9672f37d75b7559758c99f6d027607687"
SRCREV_pn-kernel-module-8723bu ??= "c849078a5209767d19321b7dded6a21d71619b2c"
SRCREV_pn-kernel-module-88x2bu ??= "342c46353b523dee8c61282eb1cab5788c7d3386"
SRCREV_pn-kernel-module-8821cu ??= "7fd04a699ef0632c890d98b755ecf09e2c2b9c39"
SRCREV_pn-kernel-module-r8723bs ??= "7708383b086b31703d5b50b8ffa45991531cbe1c"
SRCREV_pn-kernel-module-8188fu ??= "d488596918d4e339bc9b5dd3bbeabea1751b97e5"
SRCREV_pn-kernel-module-8852cu ??= "a246437004417a999aa07be85a9674f3b0bbf4bd"

#others
SRCREV_pn-yafc ??= "98afe0ccafe3739148609a1572db6e380f3ea5b2"
SRCREV_pn-rtmpdump ??= "3a69b314a5763c370406149dc1be456db294065a"
SRCREV_pn-iptvsubparser ??= "e00b59f17663b32f35395c83eb7fec644e138ece"
SRCREV_pn-f4mdump ??= "7cf456b3d47e2187f8f559f43a18cd05a31c8780"
SRCREV_pn-hlsdl ??= "42dcfa401deedbdc1af22ae9e5a8965563a6583b"
SRCREV_pn-rclone ??= "c2635e39cc462210500bbcbab43147096c8cdd35"
SRCREV_pn-djmount ??= "372370c667dbeea557c4c7ea47a8a3da3a594729"
SRCREV_pn-pyload ??= "7ce61da5dfbd0a89a6558ce2ce586694555b1bde"
SRCREV_pn-openresolv ??= "1afa8e2c1c7bdd5362afb2cc482e85fb01cf5f6d"
SRCREV_pn-ofgwrite ??= "${AUTOREV}"
SRCREV_pn-openmultiboot ??= "fd923638856fb50da631ef16ca1e7ffb6b807261"
SRCREV_pn-minisatip ??= "856996be04224a1d4fc11e11a33bd8f8e0f2bf35"

# sdgradio
SRCREV_pn-dab-cmdline-sdgradio ??= "22152fa509f52dfa2a8e6f6cfb97d2ebc444353f"
SRCREV_pn-dab-cmdline-sdgradio-pcm ??= "22152fa509f52dfa2a8e6f6cfb97d2ebc444353f"
SRCREV_pn-dab-cmdline-sdgradio-wav ??= "22152fa509f52dfa2a8e6f6cfb97d2ebc444353f"
SRCREV_pn-enigma2-plugin-extensions-sdgradio ??= "3577df700dd03ba0ac66c2766180c3863ceecab7"
SRCREV_pn-liquid-dsp ??= "4892ebbc04ef57dd6f603d3f4ece253d8c2bd571"
SRCREV_pn-redsea ??= "fcc6e1ddc787f9dba7500983a840ad21a39490c1"
SRCREV_pn-rtl-sdr ??= "ae0dd6d4f09088d13500a854091b45ad281ca4f0"
```
