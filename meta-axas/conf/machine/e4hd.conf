## meta-xpeedc/conf/machine/include/xpeedc-nextv-mipsel.inc
```bitbake
MACHINE_KERNEL_PR = "r0"

require conf/machine/include/xpeedc-nextv-essential.inc

KERNEL_MODULE_AUTOLOAD += "xfs"
IMAGE_FSTYPES += "ubi"
UBI_VOLNAME = "rootfs"

TARGET_ARCH = "mipsel"
DEFAULTTUNE ?= "mips32el"

require conf/machine/include/mips/tune-mips32.inc

# We know about rtc
MACHINE_FEATURES_BACKFILL_CONSIDERED = "rtc"

MACHINE_ESSENTIAL_EXTRA_RDEPENDS = " \
	nextv-dvb-modules-${MACHINE} \
	nextv-blindscan-dvbc-utils-${MACHINE} \
	"

#Provider
PREFERRED_PROVIDER_virtual/kernel = "linux-xpeedc-nextv"
PREFERRED_PROVIDER_virtual/blindscan-dvbc = "nextv-blindscan-dvbc-utils-${MACHINE}"

MACHINE_FEATURES += "alsa usbhost wlan 3dtv switchoff osdposition hdmicec"

MACHINE_EXTRA_RRECOMMENDS = " \
	gst-plugin-dvbmediasink \
	ntfs-3g \
	"

DVBMEDIASINK_CONFIG:mipsel = "--with-wma --with-wmv --with-pcm --with-dts --with-eac3 --with-vb6 --with-vb8 --with-spark \
	${@bb.utils.contains('MACHINE_FEATURES', 'h265', '--with-h265' , '', d)} \
	"

IMAGEVERSION := "${DISTRO_NAME}-${DISTRO_VERSION}-${DATE}"
IMAGEVERSION[vardepsexclude] = "DATE"

IMAGEDIR ?= "${MACHINE}"
IMGDEPLOYDIR ?= "${DEPLOY_DIR_IMAGE}"

# MIPSEL
IMAGE_CMD:ubifs:prepend:mipsel = " \
    rm -Rf ${IMAGE_ROOTFS}/boot/*; \
    rm -Rf ${IMAGE_ROOTFS}/tmp/*; \
    "

IMAGE_CMD:ubi:append:mipsel = " \
	mkdir -p ${IMGDEPLOYDIR}/${IMAGEDIR}; \
	cp ${IMGDEPLOYDIR}/${IMAGE_NAME}.ubi ${IMGDEPLOYDIR}/${IMAGEDIR}/rootfs.bin; \
	gzip -9c ${DEPLOY_DIR_IMAGE}/vmlinux-${MACHINE}.bin > ${IMGDEPLOYDIR}/${IMAGEDIR}/kernel.bin; \
	echo "${IMAGEVERSION}" > ${IMGDEPLOYDIR}/${IMAGEDIR}/imageversion; \
	echo "rename this file to 'force' to force an update without confirmation" > ${IMGDEPLOYDIR}/${IMAGEDIR}/noforce; \
	cd ${IMGDEPLOYDIR}; \
	zip ${DISTRO_NAME}-${DISTRO_VERSION}-${MACHINE}_usb.zip ${IMAGEDIR}/*; \
	rm -Rf ${IMAGEDIR}; \
	rm -Rf ${IMGDEPLOYDIR}/boot; \
	"
```

## meta-zgemma/conf/machine/h8.conf
```bitbake
#@TYPE: Machine
#@NAME: h8
#@DESCRIPTION: Machine configuration for the h8

SOC_FAMILY = "hisi3716mv430"
CHIPSET = "Hi3716Mv430"
HICHIPSET = "3716mv430"

BRAND_OEM = "airdigital"
MACHINE_BRAND = "Zgemma"
MACHINE_NAME = "H8.2H"

OVERRIDES:append = ":nand"
MTD_KERNEL = "mtd8"
MTD_ROOTFS = "mtd9"
KERNEL_FILE = "uImage"
ROOTFS_FILE = "rootfs.ubi"

MACHINE_FEATURES += " no-opengl wol hisil himedia hisil-3716mv430 dvb-c mali skins1080 wol no-subssupport fastboot HDMI"
OPENPLI_FEATURES += " qtplugins"
DISTRO_FEATURES:remove = "x11 wayland directfb"

# TARGET_ARCH = "aarch64"
# DEFAULTTUNE = "aarch64"
TARGET_ARCH = "arm"
DEFAULTTUNE = "cortexa7hf"

IMAGE_CLASSES += " zgemma-yaffs_image"
IMAGE_FSTYPES += " ubi zgemmayaffs"
MKUBIFS_ARGS = "-m 4096 -e 253952 -c 2048"
UBINIZE_ARGS = "-m 4096 -p 256KiB -s 4096"
UBI_VOLNAME = "rootfs"
CMDLINE ?= "console=ttyAMA0,115200n8"

RCTYPE = "25"

FORCE = "no"

require conf/machine/include/zgemma-hisil-3716mv430.inc

BBMASK = "meta-vuplus/recipes-graphics/"
BBMASK += "meta-vuplus/recipes-webkit/"
```

## meta-zgemma/conf/machine/h8se.conf
```bitbake
#@TYPE: Machine
#@NAME: h8se
#@DESCRIPTION: Machine configuration for the h9

SOC_FAMILY = "hisi3798mv200"
CHIPSET = "Hi3798Mv200"
HICHIPSET = "3798mv200"

BRAND_OEM = "airdigital"
MACHINE_BRAND = "Zgemma"
MACHINE_NAME = "H8.2Hse"

OVERRIDES:append = ":nand"
MTD_KERNEL = "mtd8"
MTD_ROOTFS = "mtd9"
KERNEL_FILE = "uImage"
ROOTFS_FILE = "rootfs.ubi"

MACHINE_FEATURES += "hdmicec hisil hisil-3798mv200 blindscan-dvbs blindscan-dvbc mali skins1080 transcoding himedia no-subssupport dvb-c bluetooth wol fastboot HDMI"
OPENPLI_FEATURES += " qtplugins kodi"
DISTRO_FEATURES:remove = "x11 wayland directfb"

# TARGET_ARCH = "aarch64"
# DEFAULTTUNE = "aarch64"
TARGET_ARCH = "arm"
DEFAULTTUNE = "cortexa15hf-neon-vfpv4"

IMAGE_CLASSES += " zgemma-yaffs_image"
IMAGE_FSTYPES += " ubi zgemmayaffs"
MKUBIFS_ARGS = "-m 4096 -e 253952 -c 2048"
UBINIZE_ARGS = "-m 4096 -p 256KiB -s 4096"
UBI_VOLNAME = "rootfs"
CMDLINE ?= "console=ttyAMA0,115200n8"

RCTYPE = "28"

FORCE = "no"

require conf/machine/include/zgemma-hisil-3798mv200.inc
```

## meta-zgemma/conf/machine/h9.conf
```bitbake
#@TYPE: Machine
#@NAME: h9
#@DESCRIPTION: Machine configuration for the h9

SOC_FAMILY = "hisi3798mv200"
CHIPSET = "Hi3798Mv200"
HICHIPSET = "3798mv200"

BRAND_OEM = "airdigital"
MACHINE_BRAND = "Zgemma"
MACHINE_NAME = "H9"

OVERRIDES:append = ":nand"
KERNEL_FILE = "uImage"
ROOTFS_FILE = "rootfs.ubi"
MTD_KERNEL = "mtd8"
MTD_ROOTFS = "mtd9"

MACHINE_FEATURES += "hdmicec hisil hisil-3798mv200 blindscan-dvbs blindscan-dvbc mali skins1080 transcoding himedia no-subssupport dvb-c bluetooth wol ciplus-helper fastboot mountboot SDcard HDMI"
OPENPLI_FEATURES += " qtplugins kodi"
DISTRO_FEATURES:remove = "x11 wayland directfb"

# TARGET_ARCH = "aarch64"
# DEFAULTTUNE = "aarch64"
TARGET_ARCH = "arm"
DEFAULTTUNE = "cortexa15hf-neon-vfpv4"

IMAGE_CLASSES += " zgemma-yaffs_image"
IMAGE_FSTYPES += " ubi zgemmayaffs"
ZGEMMA_YAFFS_PAGE_SIZE = "2k"
MKUBIFS_ARGS = "-m 2048 -e 126976 -c 8192"
UBINIZE_ARGS = "-m 2048 -p 128KiB"
UBI_VOLNAME = "rootfs"
CMDLINE ?= "console=ttyAMA0,115200n8"

RCTYPE = "28"

FORCE = "no"

require conf/machine/include/zgemma-hisil-3798mv200.inc
```

## meta-zgemma/conf/machine/i55plus.conf
```bitbake
#@TYPE: Machine
#@NAME: i55plus
#@DESCRIPTION: Machine configuration for the i55plus

SOC_FAMILY = "hisi3798mv200"
CHIPSET = "Hi3798Mv200"
HICHIPSET = "3798mv200"

BRAND_OEM = "airdigital"
MACHINE_BRAND = "Zgemma"
MACHINE_NAME = "I55 Plus"

OVERRIDES:append = ":nand"
KERNEL_FILE = "uImage"
ROOTFS_FILE = "rootfs.ubi"
MTD_KERNEL = "mtd8"
MTD_ROOTFS = "mtd9"

MACHINE_FEATURES += "hdmicec hisil hisil-3798mv200 mali skins1080 transcoding blindscan-dvbs blindscan-dvbc himedia no-subssupport wol fastboot mountboot SDcard HDMI"
OPENPLI_FEATURES += " qtplugins kodi"
DISTRO_FEATURES:remove = "x11 wayland directfb"

# TARGET_ARCH = "aarch64"
# DEFAULTTUNE = "aarch64"
TARGET_ARCH = "arm"
DEFAULTTUNE = "cortexa15hf-neon-vfpv4"

IMAGE_CLASSES += " zgemma-yaffs_image"
IMAGE_FSTYPES += " ubi zgemmayaffs"
ZGEMMA_YAFFS_PAGE_SIZE = "2k"
MKUBIFS_ARGS = "-m 2048 -e 126976 -c 8192"
UBINIZE_ARGS = "-m 2048 -p 128KiB"
UBI_VOLNAME = "rootfs"
CMDLINE ?= "console=ttyAMA0,115200n8"

RCTYPE = "25"

FORCE = "no"

require conf/machine/include/zgemma-hisil-3798mv200.inc
```

## meta-zgemma/conf/machine/include/zgemma-essential.inc
```bitbake
MACHINE_ESSENTIAL_EXTRA_RDEPENDS = "\
	zgemma-dvb-modules-${MACHINE} \
	${@bb.utils.contains('MACHINE_FEATURES', 'hisil-3798mv200', 'zgemma-libs-3798mv200 zgemma-param-3798mv200 zgemma-bootargs-3798mv200 zgemma-bootlogo-3798mv200 zgemma-fastboot-3798mv200 zgemma-recovery-3798mv200' , '', d)} \
	\
	${@bb.utils.contains('MACHINE_FEATURES', 'hisil-3798mv310', 'zgemma-libs-3798mv310 zgemma-param-3798mv310 zgemma-bootargs-3798mv310 zgemma-bootlogo-3798mv310 zgemma-fastboot-3798mv310 zgemma-recovery-3798mv310' , '', d)} \
	\
	${@bb.utils.contains('MACHINE_FEATURES', 'hisil-3716mv430', 'zgemma-libs-3716mv430 zgemma-param-3716mv430 zgemma-bootargs-3716mv430 zgemma-bootlogo-3716mv430 zgemma-fastboot-3716mv430 zgemma-recovery-3716mv430' , '', d)} \
	"

MACHINE_ESSENTIAL_EXTRA_RRECOMMENDS = "\
	kernel-module-cdfs \
	\
	${@bb.utils.contains('MACHINE_FEATURES', 'v3d-cortexa15', 'zgemma-v3ddriver-${MACHINE}' , '', d)} \
	\
	${@bb.utils.contains('MACHINE_FEATURES', 'bluetooth', 'kernel-module-btusb bluez5' , '', d)} \
	${@bb.utils.contains('MACHINE_FEATURES', 'hisil-3798mv200 ciplus-helper', 'ciplus-helper-3798mv200' , '', d)} \
	${@bb.utils.contains('MACHINE_FEATURES', 'hisil-3716mv430 ciplus-helper', 'ciplus-helper-3716mv430' , '', d)} \
	${@bb.utils.contains('MACHINE_FEATURES', 'emmc', 'resizerootfs partitions-by-name' , '', d)} \
	${@bb.utils.contains('MACHINE_FEATURES', 'hisil-3798mv200', 'kernel-module-mali-3798mv200 zgemma-mali-3798mv200' , '', d)} \
	${@bb.utils.contains('MACHINE_FEATURES', 'hisil-3798mv310', 'kernel-module-mali-3798mv310 zgemma-mali-3798mv310' , '', d)} \
	${@bb.utils.contains('MACHINE_FEATURES', 'wol', 'zgemma-ethwol' , '', d)} \
	${@bb.utils.contains('MACHINE_FEATURES', 'v3d-nxpl', 'zgemma-v3ddriver-${MACHINE}' , '', d)} \
	\
	firmware-mt7601u \
	firmware-rtl8188eu \
	firmware-rtl8192eu \
	firmware-rtl8723bu \
	firmware-rtl8xxxu \
	\
	kernel-module-8192eu \
	kernel-module-8723bu \
	kernel-module-88x2bu \
	kernel-module-8192fu \
	\
	kernel-module-mt7601u \
	kernel-module-r8723au \
	kernel-module-r8188eu \
	kernel-module-rtl8xxxu \
	"

OPTIONAL_EXTRA_DVBUSB_PACKAGES = "\
	enigma2-plugin-drivers-ct2-usb-xbox-one-tuner \
	"
```

## meta-zgemma/conf/machine/include/zgemma-hisil-3716mv430.inc
```bitbake
MACHINE_KERNEL_PR = "r0"
KERNEL_MODULE_AUTOLOAD += "xfs"

# We know about rtc
MACHINE_FEATURES_BACKFILL_CONSIDERED = "rtc"

PREFERRED_VERSION_linux-zgemma = "4.4.176"

#Provider
PREFERRED_PROVIDER_virtual/kernel ?= "linux-zgemma"
PREFERRED_PROVIDER_virtual/gstreamer1.0-dvbmediasink ?= "gstreamer1.0-plugin-dvbmediasink"
PREFERRED_PROVIDER_virtual/enigma2-mediaservice ?= "enigma2-plugin-systemplugins-servicehisilicon"

require conf/machine/include/arm/armv7a/tune-cortexa7.inc
require conf/machine/include/zgemma-essential.inc

# E2 OSD settings
EXTRA_OECONF:append:pn-enigma2 = " --with-alphablendingacceleration=always --with-blitaccelerationthreshold=250 --with-fillaccelerationthreshold=190000"

# Qt
PACKAGECONFIG_GL:pn-qtbase = " "
PACKAGECONFIG:append:pn-qtbase = " linuxfb no-opengl"

# Gstreamer dvbmediasink
DVBMEDIASINK_CONFIG = "--with-h265 --with-vb8 --with-wma --with-wmv --with-pcm  --with-eac3 --with-amr --with-spark"

MACHINE_EXTRA_RRECOMMENDS = " \
	ntfs-3g \
"

MACHINE_FEATURES += " alsa usbhost wlan 3dtv switchoff osdposition hdmicec"

IMAGEVERSION := "${DISTRO_NAME}-${DISTRO_VERSION}-${DATE}"
IMAGEVERSION[vardepsexclude] = "DATE"
IMAGEDIR ?= "zgemma"
IMAGEDIRRECOVERY ?= "zgemma-recovery"
IMGDEPLOYDIR ?= "${DEPLOY_DIR_IMAGE}"

require conf/machine/include/zgemma-partitions.inc

IMAGE_CMD:ubifs:prepend = " \
	rm -Rf ${IMAGE_ROOTFS}/boot/*; \
	rm -Rf ${IMAGE_ROOTFS}/tmp/*; \
	"

IMAGE_CMD:ubi:append = " \
	mkdir -p ${IMGDEPLOYDIR}/${IMAGEDIR}/${MACHINE}; \
	mkdir -p ${IMGDEPLOYDIR}/${IMAGEDIRRECOVERY}/${MACHINE}; \
	cp ${IMGDEPLOYDIR}/${IMAGE_NAME}.ubi ${IMGDEPLOYDIR}/${IMAGEDIR}/${MACHINE}/rootfs.ubi; \
	cp ${DEPLOY_DIR_IMAGE}/uImage ${IMGDEPLOYDIR}/${IMAGEDIR}/${MACHINE}/uImage; \
	cp ${IMGDEPLOYDIR}/${IMAGE_NAME}.ubi ${IMGDEPLOYDIR}/${IMAGEDIRRECOVERY}/${MACHINE}/rootfs.ubi; \
	cp ${DEPLOY_DIR_IMAGE}/uImage ${IMGDEPLOYDIR}/${IMAGEDIRRECOVERY}/${MACHINE}/uImage; \
	cp ${IMGDEPLOYDIR}/zgemma-partitions-${MACHINE}/${MACHINE}/bootoptions.yaffs ${IMGDEPLOYDIR}/${IMAGEDIRRECOVERY}/${MACHINE}/bootoptions.yaffs; \
	cp ${DEPLOY_DIR_IMAGE}/zgemma-partitions-${MACHINE}/update_bootargs_${MACHINE}.bin ${IMGDEPLOYDIR}/${IMAGEDIRRECOVERY}/update_bootargs_${MACHINE}.bin; \
	cp ${DEPLOY_DIR_IMAGE}/zgemma-partitions-${MACHINE}/${MACHINE}/fastboot.bin ${IMGDEPLOYDIR}/${IMAGEDIRRECOVERY}/${MACHINE}/fastboot.bin; \
	cp ${DEPLOY_DIR_IMAGE}/zgemma-partitions-${MACHINE}/${MACHINE}/bootargs.bin ${IMGDEPLOYDIR}/${IMAGEDIRRECOVERY}/${MACHINE}/bootargs.bin; \
	cp ${DEPLOY_DIR_IMAGE}/zgemma-partitions-${MACHINE}/${MACHINE}/pq_param.bin ${IMGDEPLOYDIR}/${IMAGEDIRRECOVERY}/${MACHINE}/pqparam.bin; \
	cp ${DEPLOY_DIR_IMAGE}/zgemma-partitions-${MACHINE}/${MACHINE}/baseparam.img ${IMGDEPLOYDIR}/${IMAGEDIRRECOVERY}/${MACHINE}/baseparam.img; \
	cp ${DEPLOY_DIR_IMAGE}/zgemma-partitions-${MACHINE}/${MACHINE}/logo.img ${IMGDEPLOYDIR}/${IMAGEDIRRECOVERY}/${MACHINE}/logo.img; \
	cp ${DEPLOY_DIR_IMAGE}/zgemma-partitions-${MACHINE}/${MACHINE}/recovery.bin ${IMGDEPLOYDIR}/${IMAGEDIRRECOVERY}/${MACHINE}/recovery.bin; \
	echo "${IMAGEVERSION}" > ${IMGDEPLOYDIR}/${IMAGEDIRRECOVERY}/imageversion; \
	cd ${IMGDEPLOYDIR}/${IMAGEDIRRECOVERY}; \
	zip -r ../${DISTRO_NAME}-${DISTRO_VERSION}-${MACHINE}_usb.zip *; \
	cd ..; \
	rm -Rf ${IMAGEDIRRECOVERY}; \
	cd ${IMGDEPLOYDIR}/${IMAGEDIR}; \
	zip -r ../${DISTRO_NAME}-${DISTRO_VERSION}-${MACHINE}_nand.zip *; \
	cd ..; \
	rm -Rf ${IMAGEDIR}; \
	"
```
