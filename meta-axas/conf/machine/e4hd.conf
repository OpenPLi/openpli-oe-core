## meta-vuplus/conf/machine/include/vuplus-bz2-gb-splash-initrd.inc
```bitbake
#inherit image_types_bz2_gb_splash_initrd
IMAGE_CLASSES += " image_types_bz2_gb_splash_initrd"

#IMAGE_FSTYPES ?= "tar.bz2"
IMAGE_FSTYPES =+ "tar.bz2"
```

## meta-vuplus/conf/machine/include/vuxxo.inc
```bitbake
# We know about rtc
MACHINE_FEATURES_BACKFILL_CONSIDERED = "rtc"

MACHINE_ESSENTIAL_EXTRA_RDEPENDS = " \
	vuplus-dvb-modules-${MACHINE} \
	gstreamer1.0-libav \
"

KERNEL_MODULE_AUTOLOAD += "xfs"

MACHINE_EXTRA_RRECOMMENDS = " \
	vuplus-shutdown \
	gst-plugin-dvbmediasink \
	ntfs-3g \
"

MACHINE_EXTRA_RDEPENDS += "\
	kernel-module-sr-mod \
"

EXTRA_IMAGEDEPENDS += "\
	vuplus-hbbtv-dumpait \
	vuplus-tuner-turbo \
	hmp-usb-dvb-t2-c \
"

TARGET_ARCH = "mipsel"
DEFAULTTUNE = "mips32el"

DVBMEDIASINK_CONFIG = "--with-wmv --with-pcm --with-eac3"

PREFERRED_VERSION_linux-${MACHINE} = "3.9.6"

PREFERRED_PROVIDER_virtual/kernel = "linux-${MACHINE}"

PREFERRED_PROVIDER_virtual/blindscan-dvbc = "vuplus-blindscan-utils-${MACHINE}"
PREFERRED_PROVIDER_virtual/blindscan-dvbs = "vuplus-blindscan-utils-${MACHINE}"

IMAGE_FSTYPES ?= "ubi"

UBI_VOLNAME = "rootfs"
MKUBIFS_ARGS = "-m 2048 -e 126976 -c 4096 -F"
UBINIZE_ARGS = "-m 2048 -p 128KiB"

IMAGEDIR ?= "${MACHINE}"
IMGDEPLOYDIR ?= "${DEPLOY_DIR_IMAGE}"
EXTRA_IMAGECMD_COMPAT = " --eraseblock=0x20000 -n -l "

IMAGE_CMD:ubifs:prepend = " \
	rm -rf ${IMAGE_ROOTFS}/boot/*; \
	rm -rf ${IMAGE_ROOTFS}/tmp/*; \
"

IMAGE_CMD:ubi:append = " \
	mkdir -p ${IMGDEPLOYDIR}/vuplus/${UPDATE_DIR}; \
	cp -f ${IMGDEPLOYDIR}/${IMAGE_NAME}.ubi ${IMGDEPLOYDIR}/vuplus/${UPDATE_DIR}/root_cfe_auto.jffs2; \
	gzip -f -9c ${DEPLOY_DIR_IMAGE}/vmlinux-${MACHINE}.bin > ${IMGDEPLOYDIR}/vuplus/${UPDATE_DIR}/kernel_cfe_auto.bin; \
	cd ${IMGDEPLOYDIR}; \
	zip ${DISTRO_NAME}-${DISTRO_VERSION}-${MACHINE}_usb.zip vuplus/${UPDATE_DIR}/*; \
	rm -rf vuplus; \
"

MACHINE_FEATURES += "alsa usbhost wlan 3dtv switchoff osdposition hdmicec"
# removes MIPS.xhash sections from ELF-Binary, saves 2 MB flash
LINKER_HASH_STYLE = ""
TARGET_LINK_HASH_STYLE = ""

require conf/machine/include/mips/tune-mips32.inc
```

## meta-vuplus/conf/machine/include/vuxxo4k.inc
```bitbake
# We know about rtc
MACHINE_FEATURES_BACKFILL_CONSIDERED = "rtc"

MACHINE_ESSENTIAL_EXTRA_RDEPENDS = " \
	${@bb.utils.contains("MACHINE_FEATURES", "dvbproxy", "vuplus-dvb-proxy-${MACHINE} libgles-${MACHINE} vuplus-platform-util-${MACHINE}", "vuplus-dvb-modules-${MACHINE}", d)} \
	gstreamer1.0-libav \
"

KERNEL_MODULE_AUTOLOAD += "xfs"

MACHINE_EXTRA_RRECOMMENDS = " \
	vuplus-shutdown \
	gst-plugin-dvbmediasink \
	ntfs-3g \
"

MACHINE_EXTRA_RDEPENDS += "\
	kernel-module-sr-mod \
        vuplus-kexec \
"

EXTRA_IMAGEDEPENDS += "\
	enigma2-plugin-systemplugins-remotecontrolcode \
	enigma2-plugin-extensions-addstreamurl \
	vuplus-tuner-turbo \
	vuplus-tuner-turbo2 \
	hmp-usb-dvb-t2-c-arm \
	vuplus-bluetooth-keymaps \
	${@bb.utils.contains("MACHINE_FEATURES", "bcmwifi", "vuplus-wifi-util-${MACHINE}", "", d)} \
"

TARGET_ARCH = "arm"
DEFAULTTUNE = "armv7ahf-neon"

DVBMEDIASINK_CONFIG = "--with-wmv --with-pcm --with-eac3 --with-h265 --with-dtsdownmix"

PREFERRED_VERSION_linux-${MACHINE} = "3.14.28"

PREFERRED_PROVIDER_virtual/kernel = "linux-${MACHINE}"

PREFERRED_PROVIDER_virtual/blindscan-dvbc = "vuplus-blindscan-utils-${MACHINE}"
PREFERRED_PROVIDER_virtual/blindscan-dvbs = "vuplus-blindscan-utils-${MACHINE}"

PREFERRED_PROVIDER_virtual/egl = "libgles-${MACHINE}"
PREFERRED_PROVIDER_virtual/libgles2 = "libgles-${MACHINE}"
PREFERRED_PROVIDER_virtual/kodi = "stb-kodi-${MACHINE}"

IMAGE_FSTYPES ?= "tar.bz2"

IMAGEDIR ?= "${MACHINE}"
IMGDEPLOYDIR ?= "${DEPLOY_DIR_IMAGE}"

IMAGE_CMD:tar:prepend = " \
		mkdir -p ${IMGDEPLOYDIR}/vuplus/${UPDATE_DIR}; \
		cp -f ${IMAGE_ROOTFS}/tmp/zImage ${IMGDEPLOYDIR}/vuplus/${UPDATE_DIR}/kernel_auto.bin; \
		cp -f ${IMAGE_ROOTFS}/boot/initrd_auto.bin ${IMGDEPLOYDIR}/vuplus/${UPDATE_DIR}/initrd_auto.bin; \
		touch ${IMGDEPLOYDIR}/vuplus/${UPDATE_DIR}/${FORCE_REBOOT_OPTION}.update; \
		rm -rf ${IMAGE_ROOTFS}/tmp/zImage; \
		rm -rf ${IMAGE_ROOTFS}/boot/initrd_auto.bin; \
		cd ${IMAGE_ROOTFS}; \
		rm -Rf ${IMAGE_ROOTFS}/tmp/*; \
		tar -cvf ${IMGDEPLOYDIR}/rootfs.tar -C ${IMAGE_ROOTFS} .; \
		mv -f ${IMGDEPLOYDIR}/rootfs.tar ${IMGDEPLOYDIR}/vuplus/${UPDATE_DIR}/rootfs.tar; \
		bzip2 ${IMGDEPLOYDIR}/vuplus/${UPDATE_DIR}/rootfs.tar; \
		cd ${IMGDEPLOYDIR}; \
		zip ${DISTRO_NAME}-${DISTRO_VERSION}-${MACHINE}_usb.zip vuplus/${UPDATE_DIR}/*; \
		rm -rf vuplus; \
"

MACHINE_FEATURES += "alsa usbhost wlan 3dtv switchoff osdposition hdmicec vuplus-cortexa15"
OPENPLI_FEATURES += "kodi"

require conf/machine/include/arm/arch-armv7a.inc
```

## meta-vuplus/conf/machine/include/vuxxo4klite.inc
```bitbake
# We know about rtc
MACHINE_FEATURES_BACKFILL_CONSIDERED = "rtc"

MACHINE_ESSENTIAL_EXTRA_RDEPENDS = " \
	${@bb.utils.contains("MACHINE_FEATURES", "dvbproxy", "vuplus-dvb-proxy-${MACHINE} libgles-${MACHINE} vuplus-platform-util-${MACHINE}", "vuplus-dvb-modules-${MACHINE}", d)} \
	gstreamer1.0-libav \
"

KERNEL_MODULE_AUTOLOAD += "xfs"

MACHINE_EXTRA_RRECOMMENDS = " \
	vuplus-shutdown \
	gst-plugin-dvbmediasink \
	ntfs-3g \
"

MACHINE_EXTRA_RDEPENDS += "\
"

EXTRA_IMAGEDEPENDS += "\
	enigma2-plugin-systemplugins-remotecontrolcode \
	enigma2-plugin-extensions-addstreamurl \
	vuplus-tuner-turbo \
	vuplus-tuner-turbo2 \
	hmp-usb-dvb-t2-c-arm \
	${@bb.utils.contains("MACHINE_FEATURES", "bluetooth", "enigma2-plugin-systemplugins-bluetoothsetup", "", d)} \
	${@bb.utils.contains("MACHINE_FEATURES", "bcmwifi", "vuplus-wifi-util-${MACHINE}", "", d)} \
"

TARGET_ARCH = "arm"
DEFAULTTUNE = "armv7ahf-neon"

DVBMEDIASINK_CONFIG = "--with-wmv --with-pcm --with-eac3 --with-h265 --with-dtsdownmix"


PREFERRED_PROVIDER_virtual/kernel = "linux-${MACHINE}"

PREFERRED_PROVIDER_virtual/blindscan-dvbc = "vuplus-blindscan-utils-${MACHINE}"
PREFERRED_PROVIDER_virtual/blindscan-dvbs = "vuplus-blindscan-utils-${MACHINE}"

PREFERRED_PROVIDER_virtual/egl = "libgles-${MACHINE}"
PREFERRED_PROVIDER_virtual/libgles2 = "libgles-${MACHINE}"
PREFERRED_PROVIDER_virtual/kodi = "stb-kodi-${MACHINE}"

IMAGE_FSTYPES ?= "tar.bz2"

MACHINE_FEATURES += "alsa usbhost wlan 3dtv switchoff osdposition hdmicec vuplus-cortexa15"
OPENPLI_FEATURES += "kodi"

require conf/machine/include/arm/arch-armv7a.inc
```

## meta-vuplus/conf/machine/vuduo4klite.conf
```bitbake
#@TYPE: Machine
#@NAME: Vu+ Duo4klite
#@DESCRIPTION: Machine configuration for the Vu+ Duo4klite

SOC_FAMILY = "bcm7252s"
CHIPSET = "bcm7252s"

BRAND_OEM = "vuplus"
MACHINE_BRAND = "Vu+"
MACHINE_NAME = "Duo4kLite"

FLASHSIZE = "1024"

MTD_KERNEL = "mmcblk0p4"
MTD_ROOTFS = "mmcblk0p13"
MULTIBOOT_STARTUP_DEFAULT ?= "STARTUP_1"
KERNEL_FILE = "kernel_auto.bin"
ROOTFS_FILE = "rootfs.tar.bz2"
MTD_BOOTFS = "mmcblk0p1"
MTD_BLACK  = "mmcblk0"

IMAGE_FSTYPES =+ "tar.bz2"
IMAGE_CLASSES += " image_types_bz2_gb_splash_initrd"
IMAGE_UNPACK_PATH = "vuplus/duo4klite"

MACHINE_FEATURES += " HDMI HDMI-IN-FHD hdmi-in-helper colorlcd400 ci dvb-c blindscan-dvbc blindscan-dvbs skins1080 webkithbbtv ctrlrc transcoding streamproxy dvbproxy mmc emmc fcc quadpip bluetooth chromiumos vu-eglfs"
OPENPLI_FEATURES += " kodi"

UPDATE_DIR = "duo4klite"

require conf/machine/include/vuxxo4klite.inc

require conf/machine/include/vuplus-bz2-gb-splash-initrd.inc

DVBMEDIASINK_CONFIG = "--with-dtsdownmix --with-dts --with-pcm --with-eac3 --with-amr --with-wmv --with-vb6 --with-vb8 --with-vb9 --with-spark --with-h265"

IMAGE_INSTALL:append = "\
	vuplus-initrd-${MACHINE} \
	enigma2-plugin-systemplugins-bluetoothsetup \
	vuplus-bluetooth-util-${MACHINE} \
"

FORCE_REBOOT_OPTION = "reboot"

MACHINE_KERNEL_PR = "r0"

PREFERRED_VERSION_linux-${MACHINE} = "4.1.20"
PREFERRED_VERSION_hmp-usb-dvb-t2-c-arm = "V160430"
```

## meta-vuplus/conf/machine/vuduo4kse.conf
```bitbake
#@TYPE: Machine
#@NAME: Vu+ Duo4k
#@DESCRIPTION: Machine configuration for the Vu+ Duo4kSE

SOC_FAMILY = "bcm7444"
CHIPSET = "bcm7444"

BRAND_OEM = "vuplus"
MACHINE_BRAND = "Vu+"
MACHINE_NAME = "Duo4K SE"

MTD_ROOTFS = "mmcblk0p9"
MTD_KERNEL = "mmcblk0p6"
KERNEL_FILE = "kernel_auto.bin"
ROOTFS_FILE = "rootfs.tar.bz2"
MTD_BLACK  = "mmcblk0"

MACHINE_FEATURES += " HDMI HDMI-IN-FHD skins1080 displayvfd kexecmb colorlcd480 ci quadpip dvb-c blindscan-dvbc blindscan-dvbs fcc emmc webkithbbtv ctrlrc transcoding streamproxy dvbproxy mmc inibt bcmwifi chromiumos hdmi-in-helper vu-eglfs"
OPENPLI_FEATURES += " kodi"

UPDATE_DIR = "duo4kse"

require conf/machine/include/vuxxo4k.inc

DVBMEDIASINK_CONFIG = "--with-dtsdownmix --with-dts --with-pcm --with-eac3 --with-amr --with-wmv --with-vb6 --with-vb8 --with-vb9 --with-spark --with-h265"

IMAGE_INSTALL:append = "\
	vuplus-initrd-${MACHINE} \
	vuplus-bluetooth-util-${MACHINE} \
	vuplus-wifi-util-${MACHINE} \
	"

PREFERRED_VERSION_linux-${MACHINE} = "4.1.45"
PREFERRED_VERSION_hmp-usb-dvb-t2-c-arm = "V160430"

FORCE_REBOOT_OPTION = "reboot"

MACHINE_KERNEL_PR = "r0"

IMAGE_FSTYPES =+ "ext4"
```

## meta-vuplus/conf/machine/vusolo4k.conf
```bitbake
#@TYPE: Machine
#@NAME: Vu+ Solo4k
#@DESCRIPTION: Machine configuration for the Vu+ Solo4k

SOC_FAMILY = "bcm7376"
CHIPSET = "bcm7376"

BRAND_OEM = "vuplus"
MACHINE_BRAND = "Vu+"
MACHINE_NAME = "Solo4K"

MTD_ROOTFS = "mmcblk0p4"
MTD_KERNEL = "mmcblk0p1"
KERNEL_FILE = "kernel_auto.bin"
ROOTFS_FILE = "rootfs.tar.bz2"
MTD_BLACK  = "mmcblk0"

MACHINE_FEATURES += " HDMI skins1080 displayvfd kexecmb colorlcd480 quadpip ci dvb-c blindscan-dvbc blindscan-dvbs fcc emmc webkithbbtv ctrlrc transcoding streamproxy dvbproxy mmc inibt chromiumos vu-eglfs"
OPENPLI_FEATURES += " kodi"

UPDATE_DIR = "solo4k"

require conf/machine/include/vuxxo4k.inc

DVBMEDIASINK_CONFIG = "--with-dtsdownmix --with-dts --with-pcm --with-eac3 --with-amr --with-wmv --with-vb6 --with-vb8 --with-spark --with-h265"

IMAGE_INSTALL:append = "\
	vuplus-initrd-${MACHINE} \
	vuplus-bluetooth-util-${MACHINE} \
	"

FORCE_REBOOT_OPTION = "reboot"

MACHINE_KERNEL_PR = "r1"

IMAGE_FSTYPES =+ "ext4"
```

## meta-vuplus/conf/machine/vuultimo4k.conf
```bitbake
#@TYPE: Machine
#@NAME: Vu+ Ultimo4k
#@DESCRIPTION: Machine configuration for the Vu+ Ultimo4k

SOC_FAMILY = "bcm7444"
CHIPSET = "bcm7444"

BRAND_OEM = "vuplus"
MACHINE_BRAND = "Vu+"
MACHINE_NAME = "Ultimo 4K"

MTD_ROOTFS = "mmcblk0p4"
MTD_KERNEL = "mmcblk0p1"
KERNEL_FILE = "kernel_auto.bin"
ROOTFS_FILE = "rootfs.tar.bz2"
MTD_BLACK  = "mmcblk0"

MACHINE_FEATURES += " HDMI HDMI-IN-FHD hdmi-in-helper wol wwol skins1080 displayvfd kexecmb colorlcd800 quadpip ci dvb-c blindscan-dvbc blindscan-dvbs fcc emmc bcmwifi webkithbbtv ctrlrc transcoding streamproxy dvbproxy mmc inibt chromiumos vu-eglfs"
OPENPLI_FEATURES += " kodi"

UPDATE_DIR = "ultimo4k"

require conf/machine/include/vuxxo4k.inc

DVBMEDIASINK_CONFIG = "--with-dtsdownmix --with-dts --with-pcm --with-eac3 --with-amr --with-wmv --with-vb6 --with-vb8 --with-vb9 --with-spark --with-h265"

IMAGE_INSTALL:append = "\
	vuplus-initrd-${MACHINE} \
	vuplus-bluetooth-util-${MACHINE} \
	vuplus-wifi-util-${MACHINE} \
	"

FORCE_REBOOT_OPTION = "reboot"

MACHINE_KERNEL_PR = "r1"

IMAGE_FSTYPES =+ "ext4"
```

## meta-vuplus/conf/machine/vuuno4k.conf
```bitbake
#@TYPE: Machine
#@NAME: Vu+ Uno4k
#@DESCRIPTION: Machine configuration for the Vu+ Uno4k

SOC_FAMILY = "bcm7252s"
CHIPSET = "bcm7252S"

BRAND_OEM = "vuplus"
MACHINE_BRAND = "Vu+"
MACHINE_NAME = "Uno4K"

MTD_ROOTFS = "mmcblk0p4"
MTD_KERNEL = "mmcblk0p1"
KERNEL_FILE = "kernel_auto.bin"
ROOTFS_FILE = "rootfs.tar.bz2"
MTD_BLACK  = "mmcblk0"

MACHINE_FEATURES += " HDMI ci dvb-c kexecmb blindscan-dvbc blindscan-dvbs colorlcd400 skins1080 webkithbbtv ctrlrc transcoding streamproxy dvbproxy mmc emmc fcc quadpip AV_JACK inibt chromiumos vu-eglfs"
OPENPLI_FEATURES += " kodi"

UPDATE_DIR = "uno4k"

require conf/machine/include/vuxxo4k.inc

DVBMEDIASINK_CONFIG = "--with-dtsdownmix --with-dts --with-pcm --with-eac3 --with-amr --with-wmv --with-vb6 --with-vb8 --with-vb9 --with-spark --with-h265"

IMAGE_INSTALL:append = "\
	vuplus-initrd-${MACHINE} \
	vuplus-bluetooth-util-${MACHINE} \
	"

FORCE_REBOOT_OPTION = "force"

MACHINE_KERNEL_PR = "r1"

IMAGE_FSTYPES =+ "ext4"
```

## meta-vuplus/conf/machine/vuuno4kse.conf
```bitbake
#@TYPE: Machine
#@NAME: Vu+ Uno4kSE
#@DESCRIPTION: Machine configuration for the Vu+ Uno4kSE

SOC_FAMILY = "bcm7252s"
CHIPSET = "bcm7252S"

BRAND_OEM = "vuplus"
MACHINE_BRAND = "Vu+"
MACHINE_NAME = "Uno4K SE"

MTD_ROOTFS = "mmcblk0p4"
MTD_KERNEL = "mmcblk0p1"
KERNEL_FILE = "kernel_auto.bin"
ROOTFS_FILE = "rootfs.tar.bz2"
MTD_BLACK  = "mmcblk0"

MACHINE_FEATURES += " HDMI HDMI-IN-FHD hdmi-in-helper colorlcd400 kexecmb ci dvb-c blindscan-dvbc blindscan-dvbs skins1080 webkithbbtv ctrlrc transcoding streamproxy dvbproxy mmc emmc fcc quadpip inibt chromiumos vu-eglfs"
OPENPLI_FEATURES += " kodi"

UPDATE_DIR = "uno4kse"

require conf/machine/include/vuxxo4k.inc

DVBMEDIASINK_CONFIG = "--with-dtsdownmix --with-dts --with-pcm --with-eac3 --with-amr --with-wmv --with-vb6 --with-vb8 --with-vb9 --with-spark --with-h265"

IMAGE_INSTALL:append = "\
	vuplus-initrd-${MACHINE} \
	vuplus-bluetooth-util-${MACHINE} \
"

FORCE_REBOOT_OPTION = "reboot"

MACHINE_KERNEL_PR = "r0"

IMAGE_FSTYPES =+ "ext4"

PREFERRED_VERSION_linux-${MACHINE} = "4.1.20"
PREFERRED_VERSION_hmp-usb-dvb-t2-c-arm = "V160430"
```

## meta-vuplus/conf/machine/vuzero4k.conf
```bitbake
#@TYPE: Machine
#@NAME: Vu+ Zero4K
#@DESCRIPTION: Machine configuration for the Vu+ Zero4K

SOC_FAMILY = "bcm72604"
CHIPSET = "bcm72604"

BRAND_OEM = "vuplus"
MACHINE_BRAND = "Vu+"
MACHINE_NAME = "Zero4K"

MTD_ROOTFS = "mmcblk0p7"
MTD_KERNEL = "mmcblk0p4"
KERNEL_FILE = "kernel_auto.bin"
ROOTFS_FILE = "rootfs.tar.bz2"
MTD_BLACK  = "mmcblk0"

MACHINE_FEATURES += " HDMI skins1080 kexecmb ci dvb-c blindscan-dvbc blindscan-dvbs emmc webkithbbtv ctrlrc dvbproxy mmc inibt chromiumos vu-eglfs"
OPENPLI_FEATURES += " kodi"

UPDATE_DIR = "zero4k"

require conf/machine/include/vuxxo4k.inc

DVBMEDIASINK_CONFIG = "--with-dtsdownmix --with-dts --with-pcm --with-eac3 --with-amr --with-wmv --with-vb6 --with-vb8 --with-vb9 --with-spark --with-h265"

IMAGE_INSTALL:append = "\
	vuplus-initrd-${MACHINE} \
	vuplus-bluetooth-util-${MACHINE} \
	"

FORCE_REBOOT_OPTION = "force"

MACHINE_KERNEL_PR = "r0"

IMAGE_FSTYPES =+ "ext4"

PREFERRED_VERSION_linux-${MACHINE} = "4.1.20"
PREFERRED_VERSION_hmp-usb-dvb-t2-c-arm = "V160430"
```
