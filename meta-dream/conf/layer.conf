## meta-openpli/conf/machine/include/vuxxo.inc
```bitbake
MACHINE_ESSENTIAL_EXTRA_RDEPENDS = " \
	vuplus-dvb-modules-${MACHINE} \
	"

include conf/machine/include/autoload-filesystems.inc

MACHINE_EXTRA_RRECOMMENDS = " \
	vuplus-shutdown \
	gst-plugin-dvbmediasink \
	ntfs-3g \
	"

EXTRA_IMAGEDEPENDS += "\
	vuplus-opera-browser-plugin \
	"

TARGET_ARCH = "mipsel"
DEFAULTTUNE = "mips32el"

GLIBC_EXTRA_OECONF = "--with-tls"

PREFERRED_VERSION_linux-${MACHINE} = "3.1.1"
PREFERRED_VERSION_linux-libc-headers = "3.1"

PREFERRED_PROVIDER_virtual/kernel = "linux-${MACHINE}"

PREFERRED_PROVIDER_virtual/blindscan-dvbc = "vuplus-blindscan-utils-${MACHINE}"
PREFERRED_PROVIDER_virtual/blindscan-dvbs = "vuplus-blindscan-utils-${MACHINE}"

IMAGE_FSTYPES ?= "ubi"

UBI_VOLNAME = "rootfs"
MKUBIFS_ARGS = "-m 2048 -e 126976 -c 4096 -F"
UBINIZE_ARGS = "-m 2048 -p 128KiB"

IMAGEDIR ?= "${MACHINE}"
EXTRA_IMAGECMD_COMPAT = " --eraseblock=0x20000 -n -l "

IMAGE_CMD_ubi_prepend = " \
        mkfs.jffs2 --root=${IMAGE_ROOTFS}/boot --faketime \
        --disable-compressor=lzo --compression-mode=size \
        --output=${DEPLOY_DIR_IMAGE}/${IMAGE_NAME}.boot.jffs2 \
        ${EXTRA_IMAGECMD_COMPAT}; rm -rf ${IMAGE_ROOTFS}/boot/*; \
        "

IMAGE_CMD_ubi_append = " \
        mkdir -p ${DEPLOY_DIR_IMAGE}/vuplus/${UPDATE_DIR}; \
        cp ${DEPLOY_DIR_IMAGE}/${IMAGE_NAME}.rootfs.ubi ${DEPLOY_DIR_IMAGE}/vuplus/${UPDATE_DIR}/root_cfe_auto.jffs2; \
        cp ${DEPLOY_DIR_IMAGE}/${IMAGE_NAME}.boot.jffs2 ${DEPLOY_DIR_IMAGE}/vuplus/${UPDATE_DIR}/boot_cfe_auto.jffs2; \
        gzip -f -9c ${DEPLOY_DIR_IMAGE}/vmlinux-${MACHINE}.bin > ${DEPLOY_DIR_IMAGE}/vuplus/${UPDATE_DIR}/kernel_cfe_auto.bin; \
        cd ${DEPLOY_DIR_IMAGE}; \
        zip ${IMAGE_NAME}_usb.zip vuplus/${UPDATE_DIR}/*; \
        rm -rf vuplus; \
        "

TARGET_FPU = "hard"

MACHINE_FEATURES += "alsa usbhost wifi 3dtv switchoff osdposition hdmicec"

require conf/machine/include/tune-mips32.inc
```

## meta-openpli/conf/machine/include/vuxxo2.inc
```bitbake
include conf/machine/include/openpli.inc

MACHINE_ESSENTIAL_EXTRA_RDEPENDS = " \
	vuplus-dvb-modules-${MACHINE} \
	"

include conf/machine/include/autoload-filesystems.inc

MACHINE_EXTRA_RRECOMMENDS = " \
	vuplus-shutdown \
	gst-plugin-vuplus-dvbmediasink \
	ntfs-3g \
	"

EXTRA_IMAGEDEPENDS += "\
	enigma2-plugin-systemplugins-firmwareupgrade \
	enigma2-plugin-systemplugins-remotecontrolcode \
	enigma2-plugin-systemplugins-manualfancontrol \
	enigma2-plugin-extensions-dlnabrowser \
	enigma2-plugin-extensions-dlnaserver \
	enigma2-plugin-extensions-streamtv \
	enigma2-plugin-extensions-addstreamurl \
	enigma2-plugin-systemplugins-zappingmodeselection \
	streamproxy \
"

TARGET_ARCH = "mipsel"
DEFAULTTUNE = "mips32el"

DVBMEDIASINK_CONFIG = "--with-pcm"

PREFERRED_VERSION_linux-${MACHINE} = "3.3.8"
PREFERRED_VERSION_linux-libc-headers = "3.3"

PREFERRED_PROVIDER_virtual/kernel = "linux-${MACHINE}"

PREFERRED_PROVIDER_virtual/blindscan-dvbc = "vuplus-blindscan-utils-${MACHINE}"
PREFERRED_PROVIDER_virtual/blindscan-dvbs = "vuplus-blindscan-utils-${MACHINE}"

IMAGE_FSTYPES ?= "ubi"

UBI_VOLNAME = "rootfs"
MKUBIFS_ARGS = "-m 2048 -e 126976 -c 4096"
UBINIZE_ARGS = "-m 2048 -p 128KiB"

IMAGEDIR ?= "${MACHINE}"
EXTRA_IMAGECMD_COMPAT = " --eraseblock=0x20000 -n -l "

IMAGE_CMD_ubi_prepend = " \
	cp ${IMAGE_ROOTFS}/tmp/vmlinux.gz ${DEPLOY_DIR_IMAGE}/${IMAGE_NAME}.vmlinux.gz; \
	cp ${IMAGE_ROOTFS}/boot/initrd_cfe_auto.bin ${DEPLOY_DIR_IMAGE}/${IMAGE_NAME}.initrd_cfe_auto.bin; \
	rm -f ${IMAGE_ROOTFS}/tmp/vmlinux.gz; \
	rm -f ${IMAGE_ROOTFS}/boot/initrd_cfe_auto.bin; \
"

IMAGE_CMD_ubi_append = " \
	mkdir -p ${DEPLOY_DIR_IMAGE}/vuplus/${UPDATE_DIR}; \
	cp ${DEPLOY_DIR_IMAGE}/${IMAGE_NAME}.rootfs.ubi ${DEPLOY_DIR_IMAGE}/vuplus/${UPDATE_DIR}/root_cfe_auto.bin; \
	cp ${DEPLOY_DIR_IMAGE}/${IMAGE_NAME}.vmlinux.gz ${DEPLOY_DIR_IMAGE}/vuplus/${UPDATE_DIR}/kernel_cfe_auto.bin; \
	cp ${DEPLOY_DIR_IMAGE}/${IMAGE_NAME}.initrd_cfe_auto.bin ${DEPLOY_DIR_IMAGE}/vuplus/${UPDATE_DIR}/initrd_cfe_auto.bin; \
	touch ${DEPLOY_DIR_IMAGE}/vuplus/${UPDATE_DIR}/reboot.update; \
	cd ${DEPLOY_DIR_IMAGE}; \
	zip ${IMAGE_NAME}_usb.zip vuplus/${UPDATE_DIR}/*; \
	rm -rf vuplus; \
"

TARGET_FPU = "hard"

MACHINE_FEATURES += "alsa usbhost wlan kernelwifi externalwifi 3dtv switchoff osdposition hdmicec fan"

require conf/machine/include/tune-mips32.inc
```

## meta-openpli/conf/machine/include/xp.inc
```bitbake
MACHINE_ESSENTIAL_EXTRA_RDEPENDS = "\
	xp-dvb-modules-${MACHINE} \
	"

MACHINE_ESSENTIAL_EXTRA_RRECOMMENDS = "\
	kernel-module-cdfs \
	"

include conf/machine/include/autoload-filesystems.inc

MACHINE_EXTRA_RRECOMMENDS = " \
	gst-plugin-dvbmediasink \
	ntfs-3g \
	"

CHIPSET = "bcm7358"

DVBMEDIASINK_CONFIG = "--with-wma --with-wmv --with-pcm --with-dtsdownmix"

TARGET_ARCH = "mipsel"
DEFAULTTUNE = "mips32el"

GLIBC_EXTRA_OECONF = "--with-tls --with-__thread"

PREFERRED_PROVIDER_virtual/kernel = "linux-xp"

PREFERRED_VERSION_linux-xp = "3.5.1"
PREFERRED_VERSION_linux-libc-headers = "3.3"

KERNEL_IMAGETYPE = "vmlinux"
KERNEL_OUTPUT = "${KERNEL_IMAGETYPE}"
KERNEL_CONSOLE = "null"

IMAGE_FSTYPES ?= "ubi"

UBI_VOLNAME = "rootfs"
MKUBIFS_ARGS = "-m 2048 -e 126976 -c 4096"
UBINIZE_ARGS = "-m 2048 -p 128KiB"

IMAGEDIR ?= "${MACHINE}"

IMAGE_CMD_ubi_append = " \
	mkdir -p ${DEPLOY_DIR_IMAGE}/${IMAGEDIR}; \
	cp ${DEPLOY_DIR_IMAGE}/${IMAGE_NAME}.rootfs.ubi ${DEPLOY_DIR_IMAGE}/${IMAGEDIR}/rootfs.bin; \
	gzip -c ${DEPLOY_DIR_IMAGE}/vmlinux-${MACHINE}.bin > ${DEPLOY_DIR_IMAGE}/${IMAGEDIR}/kernel.bin; \
	echo ${DISTRO_NAME}-${DISTRO_VERSION}-${DATE} > ${DEPLOY_DIR_IMAGE}/${IMAGEDIR}/imageversion; \
	echo "rename this file to 'force' to force an update without confirmation" > ${DEPLOY_DIR_IMAGE}/${IMAGEDIR}/noforce; \
	cd ${DEPLOY_DIR_IMAGE}; \
	zip ${DISTRO_NAME}-${DISTRO_VERSION}-${MACHINE}-${DATETIME}_usb.zip ${IMAGEDIR}/*; \
	rm -Rf ${IMAGEDIR}; \
	"

TARGET_FPU = "soft"

MACHINE_FEATURES += "alsa usbhost wifi 3dtv switchoff textlcd osdposition hdmicec"

require conf/machine/include/tune-mips32.inc

MACHINE_KERNEL_PR = "r0"
```

## meta-openpli/conf/machine/vuduo2.conf
```bitbake
#@TYPE: Machine
#@NAME: Vu+ Duo2
#@DESCRIPTION: Machine configuration for the Vu+ Duo2

UPDATE_DIR = "duo2"

require conf/machine/include/vuxxo2.inc

EXTRA_IMAGEDEPENDS += "\
	enigma2-plugin-systemplugins-wirelessaccesspoint \
	"

IMAGE_INSTALL_append += "\
	vuplus-initrd-${MACHINE} \
	vuplus-checkvfd \
	rt3070 \
	"

MACHINE_FEATURES += "dvb-c blindscan-dvbc blindscan-dvbs hbbtv wol ctrlrc"

CHIPSET = "bcm7424"

MACHINE_KERNEL_PR = "r0"
```

## meta-openpli/conf/machine/vusolo2.conf
```bitbake
#@TYPE: Machine
#@NAME: Vu+ Solo2
#@DESCRIPTION: Machine configuration for the Vu+ Solo2

UPDATE_DIR = "solo2"

require conf/machine/include/vuxxo2.inc

EXTRA_IMAGEDEPENDS += "\
	enigma2-plugin-systemplugins-manualfancontrol \
	enigma2-plugin-systemplugins-firmwareupgrade \
	enigma2-plugin-systemplugins-remotecontrolcode \
	"

MACHINE_FEATURES += "textlcd hbbtv transcodingsetup"

CHIPSET = "bcm7356"

MACHINE_KERNEL_PR = "r0"
```

## meta-vuplus/conf/machine/vuduo2.conf
```bitbake
#@TYPE: Machine
#@NAME: Vu+ Duo2
#@DESCRIPTION: Machine configuration for the Vu+ Duo2

UPDATE_DIR = "duo2"

require conf/machine/include/vuxxo2.inc

EXTRA_IMAGEDEPENDS += "\
	enigma2-plugin-systemplugins-wirelessaccesspoint \
	"

IMAGE_INSTALL_append += "\
	vuplus-initrd-${MACHINE} \
	enigma2-plugin-extensions-lcd4linux \
	vuplus-checkvfd \
	rt3070 \
	"

MACHINE_FEATURES += "dvb-c blindscan-dvbc blindscan-dvbs hbbtv wol ctrlrc"

CHIPSET = "bcm7424"

MACHINE_KERNEL_PR = "r0"
```
