## meta-dream/conf/layer.conf
```bitbake
# We have a conf and classes directory, append to BBPATH
BBPATH .= ":${LAYERDIR}"

BBFILES += "${LAYERDIR}/recipes-*/*/*.bb ${LAYERDIR}/recipes-*/*/*.bbappend"
```

## meta-dream/conf/machine/dm500hd.conf
```bitbake
#@TYPE: Machine
#@NAME: Dreambox DM500HD
#@DESCRIPTION: Machine configuration for the Dreambox DM500HD

OPENPLI_FEATURES = "fan usbconsole"
MACHINE_FEATURES += "modem wlan kernelwifi externalwifi dvb-c blindscan-dvbc hdmicec"

require conf/machine/include/dreambox-brcmnand.inc
require conf/machine/include/dreambox-nand-64mb.inc
require conf/machine/include/dreambox-part-64mb.inc
require conf/machine/include/dreambox-jffs2.inc
require conf/machine/include/dreambox-mips32el.inc

DVBMEDIASINK_CONFIG = "--with-pcm --with-wma --with-wmv --with-dtsdownmix --with-eac3"

CHIPSET = "bcm7405"
```

## meta-dream/conf/machine/dm7020hd.conf
```bitbake
#@TYPE: Machine
#@NAME: Dreambox DM7020HD
#@DESCRIPTION: Machine configuration for the Dreambox DM7020HD

OPENPLI_FEATURES = "ci dvd usbconsole"
MACHINE_FEATURES += "modem wlan kernelwifi externalwifi dvb-c blindscan-dvbc hdmicec"

require conf/machine/include/dreambox-hw-ecc.inc
require conf/machine/include/dreambox-nand-1024mb.inc
require conf/machine/include/dreambox-part-1024mb.inc
require conf/machine/include/dreambox-ubi.inc
require conf/machine/include/dreambox-mips32el.inc

DVBMEDIASINK_CONFIG = "--with-pcm --with-wma --with-wmv --with-dtsdownmix --with-eac3"

CHIPSET = "bcm7405"

MACHINE_EXTRA_RRECOMMENDS += "dreambox-enigma2-config"
```

## meta-dream/conf/machine/dm8000.conf
```bitbake
#@TYPE: Machine
#@NAME: Dreambox DM 8000 HD PVR
#@DESCRIPTION: Machine configuration for the Dreambox DM 8000 HD PVR

OPENPLI_FEATURES = "ci dvd"
MACHINE_FEATURES += "pci wlan kernelwifi externalwifi dvb-c blindscan-dvbc frontprocessor"

require conf/machine/include/dreambox-nand-256mb.inc
require conf/machine/include/dreambox-part-256mb.inc
require conf/machine/include/dreambox-ubi.inc
require conf/machine/include/dreambox-mips32el.inc

DVBMEDIASINK_CONFIG = "--with-pcm --with-wma --with-wmv --with-dtsdownmix --with-eac3 --with-limited-mpeg4v2"

CHIPSET = "bcm7400"

MACHINE_EXTRA_RRECOMMENDS += "dreambox-enigma2-config"
```

## meta-dream/conf/machine/dm800se.conf
```bitbake
#@TYPE: Machine
#@NAME: Dreambox DM800se
#@DESCRIPTION: Machine configuration for the Dreambox DM800se

OPENPLI_FEATURES = "fan usbconsole"
MACHINE_FEATURES += "modem wlan kernelwifi externalwifi dvb-c blindscan-dvbc hdmicec"

require conf/machine/include/dreambox-brcmnand.inc
require conf/machine/include/dreambox-nand-64mb.inc
require conf/machine/include/dreambox-part-64mb.inc
require conf/machine/include/dreambox-jffs2.inc
require conf/machine/include/dreambox-mips32el.inc

DVBMEDIASINK_CONFIG = "--with-pcm --with-wma --with-wmv --with-dtsdownmix --with-eac3"

CHIPSET = "bcm7405"

# Image fails to boot if kernel exceeds some unknown limit, so make that
# explicit here. I don't know what the actual limit is, but 6416679 boots
# and 6604470 didn't.
KERNEL_IMAGE_MAXSIZE = "6500000"
```

## meta-dream/conf/machine/include/dreambox-mips32el.inc
```bitbake
# dreambox-mips32el.inc

TARGET_ARCH = "mipsel"
DEFAULTTUNE = "mips32el"

MTD_KERNEL = "mtd2"

require conf/machine/include/dreambox.inc
require conf/machine/include/tune-mips32.inc

MACHINE_KERNEL_PR = "r14"
```

## meta-dream/conf/machine/include/dreambox-ubi.inc
```bitbake
inherit image_types_nfi

IMAGE_FSTYPES ?= "ubifs"
UBI_VOLNAME = "rootfs"
UBINIZE_VOLSIZE ?= "0"
UBINIZE_DATAVOL ?= "0"
```

## meta-dream/conf/machine/include/dreambox.inc
```bitbake
# dreambox.inc
# We know about rtc
MACHINE_FEATURES_BACKFILL_CONSIDERED = "rtc"

OPTIONAL_BSP_PACKAGES += "dreambox-buildimage"

EXTRA_IMAGEDEPENDS += "dreambox-secondstage-${MACHINE}"

MACHINE_ESSENTIAL_EXTRA_RDEPENDS += "dreambox-dvb-modules-${MACHINE}"

KERNEL_MODULE_AUTOLOAD += "xfs"

MACHINE_EXTRA_RRECOMMENDS = " \
	gstreamer1.0-plugin-dreambox-dvbmediasink \
	ntfs-3g \
	kernel-module-cifs \
	kernel-module-hmac \
	kernel-module-md4 \
	kernel-module-ecb \
	dreambox-boot-progress \
	"

MACHINE_FEATURES += "alsa usbhost 3dtv switchoff tpm dreambox"
# Add "dreambox" override for recipes
MACHINEOVERRIDES .= ":dreambox"

PREFERRED_PROVIDER_virtual/bootloader = "dreambox-secondstage-${MACHINE}"
PREFERRED_PROVIDER_virtual/kernel = "linux-dreambox"

PREFERRED_PROVIDER_virtual/blindscan-dvbs = "dreambox-blindscan-utils"
PREFERRED_PROVIDER_virtual/blindscan-dvbc = "dreambox-blindscan-utils"

PREFERRED_VERSION_linux-dreambox = "3.2"

KERNEL_IMAGETYPE = "vmlinux"
KERNEL_OUTPUT = "${KERNEL_IMAGETYPE}"
KERNEL_OUTPUT_DIR = "."
KERNEL_CONSOLE = "${@bb.utils.contains('OPENPLI_FEATURES', 'usbconsole', 'ttyS0,115200', 'null', d)}"

DREAMBOX_BUILDIMAGE = "buildimage --arch ${MACHINE} ${EXTRA_BUILDCMD} \
	--erase-block-size ${DREAMBOX_ERASE_BLOCK_SIZE} \
	--flash-size ${DREAMBOX_FLASH_SIZE} \
	--sector-size ${DREAMBOX_SECTOR_SIZE}"
```

## meta-local/conf/layer.conf
```bitbake
# We have a conf and classes directory, append to BBPATH
BBPATH .= ":${LAYERDIR}"

# We have a recipes directory, add to BBFILES
BBFILES += "${LAYERDIR}/recipes-*/*/*.bb ${LAYERDIR}/recipes-*/*/*.bbappend"

BBFILE_COLLECTIONS += "local-layer"
BBFILE_PATTERN_local-layer := "^${LAYERDIR}/"
BBFILE_PRIORITY_local-layer = "100"

LAYERSERIES_COMPAT_local-layer = "scarthgap"
```

## meta-openpli/conf/distro/openpli-common.conf
```bitbake
#@TYPE: Distribution
#@NAME: OpenPLi
#@DESCRIPTION: Embedded Linux Distribution Configuration for STB's

require reporefs.conf

DISTRO_FEATURES_BACKFILL_CONSIDERED += "pulseaudio"

DISTRO_NAME ?= "openpli"
DISTRO_HOST ?= "${@os.uname()[1]}"
DISTRO_VERSION ?= "homebuild"
DISTRO_TYPE ?= "release"

IPKG_VARIANT = "opkg"
PACKAGE_DEBUG_SPLIT_STYLE = "debug-without-src"

FEED_NAME ?= "${DISTRO_NAME}-${DISTRO_VERSION}"
DISTRO_FEED_URI ?= "http://${DISTRO_HOST}/feeds/${FEED_NAME}"
DISTRO_FEED_PREFIX ?= "${DISTRO_NAME}"

IMAGE_NAME = "${IMAGE_BASENAME}-${DISTRO_VERSION}-${MACHINE}"
IMAGE_LINK_NAME = ""
CACHE ?= "${TMPDIR}/cache/${LIBC}/${MACHINE}"
DEPLOY_DIR ?= "${TMPDIR}/deploy/${LIBC}"
DEPLOY_DIR_IMAGE = "${DEPLOY_DIR}/images/${MACHINE}"

PREFERRED_RVERSION_pyhton3-cryptography ?= "3.3.2"
PREFERRED_RVERSION_librsvg ?= "2.40.21"

PREFERRED_RPROVIDER_libfribidi = "libfribidi"
PREFERRED_RPROVIDER_libav = "ffmpeg"
PREFERRED_RPROVIDER_libid3tag = "libid3tag"
PREFERRED_RPROVIDER_libtool ?= "libtool"
PREFERRED_RPROVIDER_libtool-native ?= "libtool-native"
PREFERRED_RPROVIDER_libltdl ?= "libtool"

PREFERRED_RPROVIDER_python3-pycrypto ?= "python3-pycryptodome"
PREFERRED_RPROVIDER_python3-yenc ?= "python3-sabyenc3"

PREFERRED_RPROVIDER_ssh ?= "openssh"

PREFERRED_PROVIDER_virtual/enigma2-mediaservice ?= "enigma2-plugin-systemplugins-servicemp3"

PREFERRED_PROVIDERS += "virtual/${TARGET_PREFIX}gcc-intermediate:gcc-cross-intermediate"
PREFERRED_PROVIDERS += "virtual/${TARGET_PREFIX}gcc:gcc-cross"
PREFERRED_PROVIDERS += "virtual/${TARGET_PREFIX}g++:gcc-cross"

LICENSE_FLAGS_ACCEPTED = "commercial"
LICENSE_FLAGS_ACCEPTED = "commercial commercial_mpg123"
COMMERCIAL_AUDIO_PLUGINS ?= "gst-plugins-ugly-mad gst-plugins-ugly-mpegaudioparse"
COMMERCIAL_VIDEO_PLUGINS ?= "gst-plugins-ugly-mpeg2dec gst-plugins-ugly-mpegstream gst-plugins-bad-mpegvideoparse"

# OE optimization defaults to -O2 which makes for much larger binaries.
# Overridden here to use -Os instead, resulting in smaller images.

FULL_OPTIMIZATION = "-Os -pipe ${DEBUG_FLAGS}"

# build some core libs with better compiler optimization for better performance

O2_OPT = "-O2 -pipe ${DEBUG_FLAGS}"
O3_OPT = "-O3 -pipe ${DEBUG_FLAGS}"

FULL_OPTIMIZATION:pn-flac = "${O2_OPT}"
FULL_OPTIMIZATION:pn-jpeg = "${O2_OPT}"
FULL_OPTIMIZATION:pn-lame = "${O2_OPT}"
FULL_OPTIMIZATION:pn-liba52 = "${O2_OPT}"
FULL_OPTIMIZATION:pn-libdca = "${O2_OPT}"
FULL_OPTIMIZATION:pn-libgcrypt = "${O2_OPT}"
FULL_OPTIMIZATION:pn-libmad = "${O2_OPT}"
FULL_OPTIMIZATION:pn-libogg = "${O2_OPT}"
FULL_OPTIMIZATION:pn-libpng = "${O2_OPT}"
FULL_OPTIMIZATION:pn-libsamplerate = "${O2_OPT}"
FULL_OPTIMIZATION:pn-libvorbis = "${O2_OPT}"
FULL_OPTIMIZATION:pn-tremor = "${O2_OPT}"
FULL_OPTIMIZATION:pn-zlib = "${O2_OPT}"

DISTRO_FEATURES ?= "alsa pulseaudio bluetooth directfb ext2 largefile wifi nfs zeroconf mplt pam ${DISTRO_FEATURES_LIBC} ipv4 ipv6"

QA_LOGFILE = "${TMPDIR}/qa.log"

OEINCLUDELOGS ?= "yes"
KERNEL_CONSOLE ?= "ttyS0"

OLDEST_KERNEL = "3.2"

KERNEL_DEBUG_TIMESTAMPS = "1"

BB_GENERATE_MIRROR_TARBALLS ??= "0"

NO32LIBS ??= "1"

# Missing checksums should raise an error
BB_STRICT_CHECKSUM = "0"

# Place output in "tmp" as before, not "tmp-glibc"
TCLIBCAPPEND = ""

# Don't grab feeds for lower level archs, e.g. mips32el should not
# attempt to fetch mipsel, and armv7 need not fetch armv5 etcetera.
DISTRO_FEED_ARCHS = "all ${TUNE_PKGARCH} ${MACHINE_ARCH}"

# Use OpenSSL only
PACKAGECONFIG:pn-curl = "${@bb.utils.contains("DISTRO_FEATURES", "ipv6", "ipv6", "", d)} openssl proxy zlib"
PACKAGECONFIG:pn-openldap = "openssl modules mdb ldap meta null passwd proxycache dnssrv ${@bb.utils.contains('DISTRO_FEATURES', 'ipv6', 'ipv6', '', d)}"


# Allow java, svn and unzip executed on host
HOSTTOOLS += "java svn unzip msgfmt zip"
```

## meta-openpli/conf/distro/openpli-systemd.conf
```bitbake
#@TYPE: Distribution
#@NAME: OpenPLi
#@DESCRIPTION: Embedded Linux Distribution Configuration for STB's

require openpli-common.conf

DISTRO_VERSION = "home-systemd"

DISTRO_FEATURES_INITMAN = "systemd"
VIRTUAL-RUNTIME_init_manager = "${DISTRO_FEATURES_INITMAN}"
DISTRO_FEATURES += "systemd"
```

## meta-openpli/conf/distro/openpli.conf
```bitbake
#@TYPE: Distribution
#@NAME: OpenPLi
#@DESCRIPTION: Embedded Linux Distribution Configuration for STB's

require openpli-common.conf

VIRTUAL-RUNTIME_dev_manager = "eudev"
VIRTUAL-RUNTIME_login_manager = "busybox"
VIRTUAL-RUNTIME_init_manager = "sysvinit"
VIRTUAL-RUNTIME_initscripts = "initscripts"
```

## meta-openpli/conf/distro/stb-hardware.conf
```bitbake
DISPLAY_TYPE = "\
${@bb.utils.contains("MACHINE_FEATURES", "textlcd", "textlcd", "", d)} \
${@bb.utils.contains_any("MACHINE_FEATURES", "7segment 7seg", "7segment", "", d)} \
${@bb.utils.contains("MACHINE_FEATURES", "bwlcd96", "bwlcd96", "", d)} \
${@bb.utils.contains("MACHINE_FEATURES", "bwlcd128", "bwlcd128", "", d)} \
${@bb.utils.contains("MACHINE_FEATURES", "bwlcd140", "bwlcd140", "", d)} \
${@bb.utils.contains("MACHINE_FEATURES", "bwlcd255", "bwlcd255", "", d)} \
${@bb.utils.contains("MACHINE_FEATURES", "colorlcd128", "colorlcd128", "", d)} \
${@bb.utils.contains("MACHINE_FEATURES", "colorlcd220", "colorlcd220", "", d)} \
${@bb.utils.contains("MACHINE_FEATURES", "colorlcd390", "colorlcd390", "", d)} \
${@bb.utils.contains("MACHINE_FEATURES", "colorlcd400", "colorlcd400", "", d)} \
${@bb.utils.contains("MACHINE_FEATURES", "colorlcd480", "colorlcd480", "", d)} \
${@bb.utils.contains("MACHINE_FEATURES", "colorlcd720", "colorlcd720", "", d)} \
${@bb.utils.contains("MACHINE_FEATURES", "colorlcd800", "colorlcd800", "", d)} \
"

HAVE_TRANSCODING = "${@bb.utils.contains("MACHINE_FEATURES", "transcoding", "True", "False", d)}"

HAVE_MULTITRANSCODING = "${@bb.utils.contains("MACHINE_FEATURES", "multitranscoding", "True", "False", d)}"

HAVE_MULTILIB = "${@bb.utils.contains("MACHINE_FEATURES", "multilib", "True", "False", d)}"

HAVE_HDMI = "${@bb.utils.contains("MACHINE_FEATURES", "HDMI", "True", "False", d)}"
HAVE_YUV = "${@bb.utils.contains("MACHINE_FEATURES", "YUV", "True", "False", d)}"
HAVE_RCA = "${@bb.utils.contains("MACHINE_FEATURES", "RCA", "True", "False", d)}"
HAVE_AV_JACK = "${@bb.utils.contains("MACHINE_FEATURES", "AV_JACK", "True", "False", d)}"
HAVE_SCART = "${@bb.utils.contains("MACHINE_FEATURES", "SCART", "True", "False", d)}"
HAVE_DVI = "${@bb.utils.contains("MACHINE_FEATURES", "DVI", "True", "False", d)}"
HAVE_SVIDEO = "${@bb.utils.contains("MACHINE_FEATURES", "SVIDEO", "True", "False", d)}"
HAVE_HDMI_IN_HD = "${@bb.utils.contains("MACHINE_FEATURES", "HDMI-IN-HD", "True", "False", d)}"
HAVE_HDMI_IN_FHD = "${@bb.utils.contains("MACHINE_FEATURES", "HDMI-IN-FHD", "True", "False", d)}"

HAVE_WOL = "${@bb.utils.contains("MACHINE_FEATURES", "wol", "True", "False", d)}"
HAVE_CI = "${@bb.utils.contains("MACHINE_FEATURES", "ci", "True", "False", d)}"

HAVE_FHDSKIN = "${@bb.utils.contains("MACHINE_FEATURES", "nofhdskin", "False", "True", d)}"

RCTYPE ??= "0"
RCNAME ??= "dmm"
RCIDNUM ??= "2"

BLINDSCAN_BINARY ?= "blindscan"

STB_PLATFORM ?= "${MACHINE}"
```

## meta-openpli/conf/layer.conf
```bitbake
# We have a conf and classes directory, append to BBPATH
BBPATH .= ":${LAYERDIR}"

# We have a recipes directory, add to BBFILES
BBFILES += "${LAYERDIR}/recipes-*/*/*.bb ${LAYERDIR}/recipes-*/*/*.bbappend"

BBFILE_COLLECTIONS += "openpli-layer"
BBFILE_PATTERN_openpli-layer := "^${LAYERDIR}/"
BBFILE_PRIORITY_openpli-layer = "7"

OPENPLI_BASE := '${@os.path.normpath("${LAYERDIR}/../")}'
# Prevent current directory creeping into sstate objects. Otherwise, building
# in another TOPDIR will cause recipes using this variable to be rebuilt.
OPENPLI_BASE[vardepvalue] = 'meta-openpli'

PYTHON_PN = "python3"

LICENSE_PATH += "${LAYERDIR}/licenses"

INSANE_SKIP:${PN} += "already-stripped ldflags"

LAYERSERIES_COMPAT_openpli-layer = "kirkstone"

# Revert OE-core insane.bbclass change, where these warnings became errors
ERROR_QA:remove = "already-stripped installed-vs-shipped ldflags compile-host-path \
                    install-host-path pn-overrides unknown-configure-option \
                    useless-rpaths rpaths staticdev empty-dirs patch-fuzz patch-status"
WARN_QA:append = "already-stripped installed-vs-shipped ldflags compile-host-path \
                    install-host-path pn-overrides unknown-configure-option \
                    useless-rpaths rpaths staticdev patch-fuzz"

WARN_QA:remove = "src-uri-bad buildpaths invalid-packageconfig patch-fuzz"
```

## meta-openpli/conf/machine/et10000.conf
```bitbake
#@TYPE: Machine
#@NAME: Xtrend et10000
#@DESCRIPTION: Machine configuration for the Xtrend et10000

CHIPSET = "bcm7425"
TARGET_FPU = "hard"

require conf/machine/include/etxx00-2g.inc
```

## meta-openpli/conf/machine/et5x00.conf
```bitbake
#@TYPE: Machine
#@NAME: Xtrend et5x00
#@DESCRIPTION: Machine configuration for the Xtrend et5x00

CHIPSET = "bcm7413"
TARGET_FPU = "hard"

MACHINE_FEATURES += "blindscan-dvbs"

require conf/machine/include/etxx00.inc
```

## meta-openpli/conf/machine/et6x00.conf
```bitbake
#@TYPE: Machine
#@NAME: Xtrend et6x00
#@DESCRIPTION: Machine configuration for the Xtrend et6x00

CHIPSET = "bcm7413"
TARGET_FPU = "hard"

MACHINE_FEATURES += "blindscan-dvbs"

require conf/machine/include/etxx00.inc
```

## meta-openpli/conf/machine/et8000.conf
```bitbake
#@TYPE: Machine
#@NAME: Xtrend et8000
#@DESCRIPTION: Machine configuration for the Xtrend et8000

MACHINE_FEATURES += "textlcd dvb-c"

CHIPSET = "bcm7241"
TARGET_FPU = "hard"

require conf/machine/include/etxx00-2g.inc
```

## meta-openpli/conf/machine/include/etxx00-2g.inc
```bitbake
require conf/machine/include/et.inc

PREFERRED_PROVIDER_virtual/kernel = "linux-etxx00-2g"

MKUBIFS_ARGS = "-m 2048 -e 126976 -c 8192"
UBINIZE_ARGS = "-m 2048 -p 128KiB"

IMAGE_CMD_ubi_prepend = " \
	rm -Rf ${IMAGE_ROOTFS}/tmp/*; \
	"

MACHINE_FEATURES += "extrakernelwifi"

MACHINE_KERNEL_PR = "r0"
```
