## meta-vuplus/conf/machine/vusolo2.conf
```bitbake
#@TYPE: Machine
#@NAME: Vu+ Solo2
#@DESCRIPTION: Machine configuration for the Vu+ Solo2

UPDATE_DIR = "solo2"

require conf/machine/include/vuxxo2.inc

IMAGE_INSTALL_append += "vuplus-initrd-${MACHINE}"

MACHINE_FEATURES += "textlcd hbbtv"

CHIPSET = "bcm7356"

MACHINE_KERNEL_PR = "r1"
```

## meta-xp/conf/machine/xp1000.conf
```bitbake
#@TYPE: Machine
#@NAME: xp1000
#@DESCRIPTION: Machine configuration for the xp1000

DEFAULTTUNE = "mips32el-nf"

require conf/machine/include/xp.inc
```

## meta-xtrend/conf/machine/et10000.conf
```bitbake
#@TYPE: Machine
#@NAME: Xtrend et10000
#@DESCRIPTION: Machine configuration for the Xtrend et10000

MACHINE_FEATURES += "dvb-c"

CHIPSET = "bcm7425"
TARGET_FPU = "hard"

require conf/machine/include/etxx00-2g.inc
```

## meta-xtrend/conf/machine/et9x00.conf
```bitbake
#@TYPE: Machine
#@NAME: Xtrend et9x00
#@DESCRIPTION: Machine configuration for the Xtrend et9x00

CHIPSET = "bcm7413"
TARGET_FPU = "hard"

MACHINE_FEATURES += "blindscan-dvbs"

require conf/machine/include/etxx00.inc
```

## meta-xtrend/conf/machine/include/et.inc
```bitbake
# We know about rtc
MACHINE_FEATURES_BACKFILL_CONSIDERED = "rtc"


MACHINE_ESSENTIAL_EXTRA_RDEPENDS = "\
	et-dvb-modules-${MACHINE} \
	"

MACHINE_ESSENTIAL_EXTRA_RRECOMMENDS = "\
	kernel-module-cdfs \
	"

KERNEL_MODULE_AUTOLOAD += "xfs"

MACHINE_EXTRA_RRECOMMENDS = " \
	gst-plugin-dvbmediasink \
	ntfs-3g \
	"

DVBMEDIASINK_CONFIG = "--with-wma --with-wmv --with-pcm --with-dts --with-eac3"

TARGET_ARCH = "mipsel"
DEFAULTTUNE = "mips32el"

PREFERRED_VERSION_linux-libc-headers = "3.3"

KERNEL_IMAGETYPE = "vmlinux"
KERNEL_OUTPUT = "${KERNEL_IMAGETYPE}"
KERNEL_CONSOLE = "null"

IMAGE_FSTYPES ?= "ubi"

UBI_VOLNAME = "rootfs"

IMAGEDIR ?= "${MACHINE}"

IMAGE_CMD_ubi_append = " \
	mkdir -p ${DEPLOY_DIR_IMAGE}/${IMAGEDIR}; \
	cp ${DEPLOY_DIR_IMAGE}/${IMAGE_NAME}.rootfs.ubi ${DEPLOY_DIR_IMAGE}/${IMAGEDIR}/rootfs.bin; \
	gzip -9c ${DEPLOY_DIR_IMAGE}/vmlinux-${MACHINE}.bin > ${DEPLOY_DIR_IMAGE}/${IMAGEDIR}/kernel.bin; \
	echo ${DISTRO_NAME}-${DISTRO_VERSION}-${DATE} > ${DEPLOY_DIR_IMAGE}/${IMAGEDIR}/imageversion; \
	echo "rename this file to 'force' to force an update without confirmation" > ${DEPLOY_DIR_IMAGE}/${IMAGEDIR}/noforce; \
	cd ${DEPLOY_DIR_IMAGE}; \
	zip ${DISTRO_NAME}-${DISTRO_VERSION}-${MACHINE}_usb.zip ${IMAGEDIR}/*; \
	rm -Rf ${IMAGEDIR}; \
	"

MACHINE_FEATURES += "alsa usbhost wlan kernelwifi 3dtv switchoff osdposition hdmicec"

require conf/machine/include/tune-mips32.inc
```

## meta-xtrend/conf/machine/include/etxx00.inc
```bitbake
require conf/machine/include/et.inc

PREFERRED_PROVIDER_virtual/kernel = "linux-etxx00"
PREFERRED_PROVIDER_virtual/blindscan-dvbs = "et-blindscan-dvbs-utils"

MKUBIFS_ARGS = "-m 2048 -e 126976 -c 4096"
UBINIZE_ARGS = "-m 2048 -p 128KiB"

IMAGE_CMD_ubi_prepend = " \
	rm -Rf ${IMAGE_ROOTFS}/tmp/*; \
	"

MACHINE_FEATURES += "externalwifi textlcd"

MACHINE_KERNEL_PR = "r6"
```
